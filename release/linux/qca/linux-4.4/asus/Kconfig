## release/linux/qca/linux-4.4/asus/Kconfig
```kconfig
choice
	prompt "Choose Product"
	help
	   Choose specific product for different hardware layout

config RTAC82U
	bool "RT-AC82U (IPQ4019 + QCA9984)"

config RTAC95U
	bool "RT-AC95U (IPQ4019 + QCA9984)"

config PLAX56XP4
	bool "PL-AX56_XP4 (IPQ6018 + QCA7550)"

config QIHOO360V6
	bool "360v6 (IPQ6000 + QCA8075)"

config GLAX1800
	bool "GL-AX1800 (IPQ6000 + QCA8075)"

config JDCAX1800
	bool "JDCAX1800 (IPQ6000 + QCA8075)"

endchoice
```

## release/linux/qca/linux-4.4/drivers/Documentation/devicetree/bindings/sound/qca,ipq8074-audio-adss.txt
```
* Qualcomm Technologies, Inc IPQ8074 ASoC audio subsystem driver

This node models the Qualcomm Technologies, Inc IPQ8074 ASoC audio subsystem driver

Required properties:

- compatible	: "qca,ipq8074-audio-adss"
- reg		: should have the stereo register address, length
- resets	: references to the reset controllers
- reset-names	: should be "blk_rst"

Additionally, for slave mode we require a boolean called "slave;" in the node.

Example:

master:
audio: audio@7700000 {
	compatible = "qca,ipq8074-audio-adss";
	reg = <0x7700000 0x34>;
	resets = <&gcc AUDIO_BLK_ARES>;
	reset-names = "blk_rst";
	status = "disabled";
};

slave:
audio: audio@7700000 {
	compatible = "qca,ipq8074-audio-adss";
	reg = <0x7700000 0x34>;
	resets = <&gcc AUDIO_BLK_ARES>;
	reset-names = "blk_rst";
	status = "disabled";
	slave;
}
```

## release/linux/qca/linux-4.4/drivers/arch/arm/mach-qcom/Kconfig
```kconfig
menuconfig ARCH_QCOM
	bool "Qualcomm Support" if ARCH_MULTI_V7
	select ARCH_SUPPORTS_BIG_ENDIAN
	select ARM_GIC
	select ARM_AMBA
	select PINCTRL
	select ARCH_WANT_KMAP_ATOMIC_FLUSH
	select QCOM_SCM if SMP
	select PCI_DOMAINS if PCI
	help
	  Support for Qualcomm's devicetree based systems.

if ARCH_QCOM

config ARCH_MSM8X60
	bool "Enable support for MSM8X60"
	select CLKSRC_QCOM

config ARCH_MSM8960
	bool "Enable support for MSM8960"
	select CLKSRC_QCOM

config ARCH_MSM8974
	bool "Enable support for MSM8974"
	select HAVE_ARM_ARCH_TIMER

config ARCH_IPQ256M
	bool "Enable 256M config"
	default n
	help
	  This sets the text offset of 256M profile, which makes kernel aware of
          first 16MB of DDR.

config SKB_FIXED_SIZE_2K
	bool "SKB size fixed at 2K"
	default n
	help
		This is a hint to the NSS driver that the ‘skbuff’ size might
		need to be fixed at 2KB, to conserve memory.

config ARCH_IPQ807x
	bool "Enable Support for IPQ807x"
	select PINCTRL_IPQ807x
	select COMMON_CLK_QCOM
	select IPQ_APSS_807x
	select IPQ_GCC_807x
	help
	  This enables support for the IPQ807x chipset. If you dont
	  know what do here, say N

config ARCH_IPQ6018
	bool "Enable Support for IPQ6018"
	select PINCTRL_IPQ6018
	select COMMON_CLK_QCOM
	select IPQ_APSS_6018
	select IPQ_GCC_6018
	help
	  This enables support for the IPQ6018 chipset. If you dont
	  know what do here, say N

config IPQ_MEM_PROFILE
	int "Select Memory Profile"
	range 0 1024
	default 0
	---help---
	This option select memory profile to be used,which defines
	the reserved memory configuration used in device tree.

	If unsure, say 0
endif
```

## release/linux/qca/linux-4.4/drivers/drivers/nvram/Kconfig
```kconfig
menu "ASUS NVRAM"

config	ASUS_NVRAM_API
	tristate "ASUS NVRAM R/W API"
	default m
	---help---
	ASUS NVRAM R/W API

config NVRAM_SIZE
	hex "Specify nvram size on Ralink/MTK/QCA platform. First 4KB is reserved to U-Boot environment."
	depends on ASUS_NVRAM_API
	default 0x10000

endmenu
```

## release/linux/qca/linux-5.4/swrt/Kconfig.misc
```kconfig
menu "SWRT Miscellaneous options"

config  MODEL_RTAX89U
        bool "RT-AX89U"
        default n

config  MODEL_RAX120
        bool "RAX120"
        default n

config  MODEL_XMAX3600
        bool "XM-AX3600"
        default n

config  MODEL_360V6
        bool "360V6"
        default n

config  MODEL_RMAX5
        bool "RM-AX5"
        default n

config  MODEL_TUFBE6500
        bool "TUF-BE6500"
        default n

config  MODEL_JDCBE6500
        bool "JDC-BE6500"
        default n

endmenu        
```

## release/src-lantiq/grx500/iwlwav-dev/Kconfig.local
```kconfig
config BACKPORTED_BACKPORT_DIR
	tristate
	default BACKPORT_DIR
config BACKPORTED_BACKPORTS_VERSION
	tristate
	default BACKPORTS_VERSION
config BACKPORTED_BACKPORTED_KERNEL_VERSION
	tristate
	default BACKPORTED_KERNEL_VERSION
config BACKPORTED_BACKPORTED_KERNEL_NAME
	tristate
	default BACKPORTED_KERNEL_NAME
config BACKPORTED_WIRELESS
	tristate
	default WIRELESS
config BACKPORTED_NET_CORE
	tristate
	default NET_CORE
config BACKPORTED_EXPERT
	tristate
	default EXPERT
config BACKPORTED_BP_MODULES
	tristate
	default BP_MODULES
config BACKPORTED_BPAUTO_BUILD_CORDIC
	tristate
	default BPAUTO_BUILD_CORDIC
config BACKPORTED_BPAUTO_CORDIC
	tristate
	default BPAUTO_CORDIC
config BACKPORTED_BPAUTO_MII
	tristate
	default BPAUTO_MII
config BACKPORTED_BPAUTO_BUILD_LEDS
	tristate
	default BPAUTO_BUILD_LEDS
config BACKPORTED_BPAUTO_NEW_LEDS
	tristate
	default BPAUTO_NEW_LEDS
config BACKPORTED_BPAUTO_LEDS_CLASS
	tristate
	default BPAUTO_LEDS_CLASS
config BACKPORTED_BPAUTO_LEDS_TRIGGERS
	tristate
	default BPAUTO_LEDS_TRIGGERS
config BACKPORTED_BPAUTO_USERSEL_BUILD_ALL
	tristate
	default BPAUTO_USERSEL_BUILD_ALL
config BACKPORTED_BPAUTO_WANT_DEV_COREDUMP
	tristate
	default BPAUTO_WANT_DEV_COREDUMP
config BACKPORTED_BPAUTO_BUILD_WANT_DEV_COREDUMP
	tristate
	default BPAUTO_BUILD_WANT_DEV_COREDUMP
config BACKPORTED_BPAUTO_RHASHTABLE
	tristate
	default BPAUTO_RHASHTABLE
config BACKPORTED_BPAUTO_BUCKET_LOCKS
	tristate
	default BPAUTO_BUCKET_LOCKS
config BACKPORTED_BPAUTO_REFCOUNT
	tristate
	default BPAUTO_REFCOUNT
config BACKPORTED_BPAUTO_SYSTEM_DATA_VERIFICATION
	tristate
	default BPAUTO_SYSTEM_DATA_VERIFICATION
config BACKPORTED_BPAUTO_BUILD_SYSTEM_DATA_VERIFICATION
	tristate
	default BPAUTO_BUILD_SYSTEM_DATA_VERIFICATION
config BACKPORTED_BPAUTO_PUBLIC_KEY
	tristate
	default BPAUTO_PUBLIC_KEY
config BACKPORTED_BPAUTO_ASN1_DECODER
	tristate
	default BPAUTO_ASN1_DECODER
config BACKPORTED_BPAUTO_PKCS7
	tristate
	default BPAUTO_PKCS7
config BACKPORTED_WIRELESS_EXT
	tristate
	default WIRELESS_EXT
config BACKPORTED_WEXT_CORE
	tristate
	default WEXT_CORE
config BACKPORTED_WEXT_PROC
	tristate
	default WEXT_PROC
config BACKPORTED_WEXT_SPY
	tristate
	default WEXT_SPY
config BACKPORTED_WEXT_PRIV
	tristate
	default WEXT_PRIV
config BACKPORTED_CFG80211
	tristate
	default CFG80211
config BACKPORTED_NL80211_TESTMODE
	tristate
	default NL80211_TESTMODE
config BACKPORTED_CFG80211_DEVELOPER_WARNINGS
	tristate
	default CFG80211_DEVELOPER_WARNINGS
config BACKPORTED_CFG80211_CERTIFICATION_ONUS
	tristate
	default CFG80211_CERTIFICATION_ONUS
config BACKPORTED_CFG80211_REQUIRE_SIGNED_REGDB
	tristate
	default CFG80211_REQUIRE_SIGNED_REGDB
config BACKPORTED_CFG80211_USE_KERNEL_REGDB_KEYS
	tristate
	default CFG80211_USE_KERNEL_REGDB_KEYS
config BACKPORTED_CFG80211_EXTRA_REGDB_KEYDIR
	tristate
	default CFG80211_EXTRA_REGDB_KEYDIR
config BACKPORTED_CFG80211_REG_CELLULAR_HINTS
	tristate
	default CFG80211_REG_CELLULAR_HINTS
config BACKPORTED_CFG80211_REG_RELAX_NO_IR
	tristate
	default CFG80211_REG_RELAX_NO_IR
config BACKPORTED_CFG80211_DEFAULT_PS
	tristate
	default CFG80211_DEFAULT_PS
config BACKPORTED_CFG80211_DEBUGFS
	tristate
	default CFG80211_DEBUGFS
config BACKPORTED_CFG80211_CRDA_SUPPORT
	tristate
	default CFG80211_CRDA_SUPPORT
config BACKPORTED_CFG80211_WEXT
	tristate
	default CFG80211_WEXT
config BACKPORTED_CFG80211_WEXT_EXPORT
	tristate
	default CFG80211_WEXT_EXPORT
config BACKPORTED_LIB80211
	tristate
	default LIB80211
config BACKPORTED_LIB80211_CRYPT_WEP
	tristate
	default LIB80211_CRYPT_WEP
config BACKPORTED_LIB80211_CRYPT_CCMP
	tristate
	default LIB80211_CRYPT_CCMP
config BACKPORTED_LIB80211_CRYPT_TKIP
	tristate
	default LIB80211_CRYPT_TKIP
config BACKPORTED_LIB80211_DEBUG
	tristate
	default LIB80211_DEBUG
config BACKPORTED_MAC80211
	tristate
	default MAC80211
config BACKPORTED_MAC80211_HAS_RC
	tristate
	default MAC80211_HAS_RC
config BACKPORTED_MAC80211_RC_MINSTREL
	tristate
	default MAC80211_RC_MINSTREL
config BACKPORTED_MAC80211_RC_DEFAULT_MINSTREL
	tristate
	default MAC80211_RC_DEFAULT_MINSTREL
config BACKPORTED_MAC80211_RC_DEFAULT
	tristate
	default MAC80211_RC_DEFAULT
config BACKPORTED_MAC80211_MESH
	tristate
	default MAC80211_MESH
config BACKPORTED_MAC80211_LEDS
	tristate
	default MAC80211_LEDS
config BACKPORTED_MAC80211_DEBUGFS
	tristate
	default MAC80211_DEBUGFS
config BACKPORTED_MAC80211_MESSAGE_TRACING
	tristate
	default MAC80211_MESSAGE_TRACING
config BACKPORTED_MAC80211_DEBUG_MENU
	tristate
	default MAC80211_DEBUG_MENU
config BACKPORTED_MAC80211_NOINLINE
	tristate
	default MAC80211_NOINLINE
config BACKPORTED_MAC80211_VERBOSE_DEBUG
	tristate
	default MAC80211_VERBOSE_DEBUG
config BACKPORTED_MAC80211_MLME_DEBUG
	tristate
	default MAC80211_MLME_DEBUG
config BACKPORTED_MAC80211_STA_DEBUG
	tristate
	default MAC80211_STA_DEBUG
config BACKPORTED_MAC80211_HT_DEBUG
	tristate
	default MAC80211_HT_DEBUG
config BACKPORTED_MAC80211_OCB_DEBUG
	tristate
	default MAC80211_OCB_DEBUG
config BACKPORTED_MAC80211_IBSS_DEBUG
	tristate
	default MAC80211_IBSS_DEBUG
config BACKPORTED_MAC80211_PS_DEBUG
	tristate
	default MAC80211_PS_DEBUG
config BACKPORTED_MAC80211_MPL_DEBUG
	tristate
	default MAC80211_MPL_DEBUG
config BACKPORTED_MAC80211_MPATH_DEBUG
	tristate
	default MAC80211_MPATH_DEBUG
config BACKPORTED_MAC80211_MHWMP_DEBUG
	tristate
	default MAC80211_MHWMP_DEBUG
config BACKPORTED_MAC80211_MESH_SYNC_DEBUG
	tristate
	default MAC80211_MESH_SYNC_DEBUG
config BACKPORTED_MAC80211_MESH_CSA_DEBUG
	tristate
	default MAC80211_MESH_CSA_DEBUG
config BACKPORTED_MAC80211_MESH_PS_DEBUG
	tristate
	default MAC80211_MESH_PS_DEBUG
config BACKPORTED_MAC80211_TDLS_DEBUG
	tristate
	default MAC80211_TDLS_DEBUG
config BACKPORTED_MAC80211_DEBUG_COUNTERS
	tristate
	default MAC80211_DEBUG_COUNTERS
config BACKPORTED_MAC80211_STA_HASH_MAX_SIZE
	tristate
	default MAC80211_STA_HASH_MAX_SIZE
config BACKPORTED_WLAN
	tristate
	default WLAN
config BACKPORTED_WIRELESS_WDS
	tristate
	default WIRELESS_WDS
config BACKPORTED_PCMCIA_RAYCS
	tristate
	default PCMCIA_RAYCS
config BACKPORTED_PCMCIA_WL3501
	tristate
	default PCMCIA_WL3501
config BACKPORTED_MAC80211_HWSIM
	tristate
	default MAC80211_HWSIM
config BACKPORTED_USB_NET_RNDIS_WLAN
	tristate
	default USB_NET_RNDIS_WLAN
config BACKPORTED_VIRT_WIFI
	tristate
	default VIRT_WIFI
config BACKPORTED_WLAN_VENDOR_INTEL
	tristate
	default WLAN_VENDOR_INTEL
config BACKPORTED_IWLWAV
	tristate
	default IWLWAV
config BACKPORTED_IWLWAV_PMCU_SUPPORT
	tristate
	default IWLWAV_PMCU_SUPPORT
config BACKPORTED_IWLWAV_PUMA6_UDMA_SUPPORT
	tristate
	default IWLWAV_PUMA6_UDMA_SUPPORT
config BACKPORTED_IWLWAV_DC_DP_LIB_SUPPORT
	tristate
	default IWLWAV_DC_DP_LIB_SUPPORT
config BACKPORTED_IWLWAV_GEN6_USE_LEGACY_INT
	tristate
	default IWLWAV_GEN6_USE_LEGACY_INT
config BACKPORTED_IWLWAV_BUS_PCI_PCIE
	tristate
	default IWLWAV_BUS_PCI_PCIE
config BACKPORTED_IWLWAV_EEPROM_SUPPORT
	tristate
	default IWLWAV_EEPROM_SUPPORT
config BACKPORTED_IWLWAV_USE_INTERRUPT_POLLING
	tristate
	default IWLWAV_USE_INTERRUPT_POLLING
config BACKPORTED_IWLWAV_SET_PM_QOS
	tristate
	default IWLWAV_SET_PM_QOS
config BACKPORTED_IWLWAV_LEGACY_INT_RECOVERY_MON
	tristate
	default IWLWAV_LEGACY_INT_RECOVERY_MON
config BACKPORTED_IWLWAV_DEBUG
	tristate
	default IWLWAV_DEBUG
config BACKPORTED_IWLWAV_ENABLE_OBJPOOL
	tristate
	default IWLWAV_ENABLE_OBJPOOL
config BACKPORTED_IWLWAV_ENABLE_NBUF_OBJPOOL
	tristate
	default IWLWAV_ENABLE_NBUF_OBJPOOL
config BACKPORTED_IWLWAV_TXMM_HISTORY_LENGTH
	tristate
	default IWLWAV_TXMM_HISTORY_LENGTH
config BACKPORTED_IWLWAV_TRACER_HISTORY_LENGTH
	tristate
	default IWLWAV_TRACER_HISTORY_LENGTH
config BACKPORTED_IWLWAV_CPU_STAT
	tristate
	default IWLWAV_CPU_STAT
config BACKPORTED_IWLWAV_BENCHMARK_TOOLS
	tristate
	default IWLWAV_BENCHMARK_TOOLS
config BACKPORTED_IWLWAV_CCR_DEBUG
	tristate
	default IWLWAV_CCR_DEBUG
config BACKPORTED_IWLWAV_FW_WRITE_VALIDATION
	tristate
	default IWLWAV_FW_WRITE_VALIDATION
config BACKPORTED_IWLWAV_STAT_CNTRS_DEBUG
	tristate
	default IWLWAV_STAT_CNTRS_DEBUG
config BACKPORTED_IWLWAV_PER_PACKET_STATS
	tristate
	default IWLWAV_PER_PACKET_STATS
config BACKPORTED_IWLWAV_PRINT_PER_PACKET_STATS
	tristate
	default IWLWAV_PRINT_PER_PACKET_STATS
config BACKPORTED_IWLWAV_TSF_TIMER_TIMESTAMPS_IN_DEBUG_PRINTOUTS
	tristate
	default IWLWAV_TSF_TIMER_TIMESTAMPS_IN_DEBUG_PRINTOUTS
config BACKPORTED_IWLWAV_TSF_TIMER_ACCESS_ENABLED
	tristate
	default IWLWAV_TSF_TIMER_ACCESS_ENABLED
config BACKPORTED_IWLWAV_NO_FW_RESET_ON_STOP
	tristate
	default IWLWAV_NO_FW_RESET_ON_STOP
config BACKPORTED_IWLWAV_PKT_INJECT
	tristate
	default IWLWAV_PKT_INJECT
config BACKPORTED_IWLWAV_ETH_PARSER
	tristate
	default IWLWAV_ETH_PARSER
config BACKPORTED_IWLWAV_VALIDATE_IFNAME
	tristate
	default IWLWAV_VALIDATE_IFNAME
config BACKPORTED_IWLWAV_FILTER_BLACKLISTED_BSS
	tristate
	default IWLWAV_FILTER_BLACKLISTED_BSS
config BACKPORTED_IWLWAV_RT_LOGGER_FUNCTIONS
	tristate
	default IWLWAV_RT_LOGGER_FUNCTIONS
config BACKPORTED_IWLWAV_RT_LOGGER_INLINES
	tristate
	default IWLWAV_RT_LOGGER_INLINES
config BACKPORTED_IWLWAV_MAX_DLEVEL
	tristate
	default IWLWAV_MAX_DLEVEL
config BACKPORTED_IWLWAV_SILENT
	tristate
	default IWLWAV_SILENT
config BACKPORTED_IWLWAV_USE_GENL
	tristate
	default IWLWAV_USE_GENL
```

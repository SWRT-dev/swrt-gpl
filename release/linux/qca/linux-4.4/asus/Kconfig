## release/src-ra-openwrt-4210/linux/linux-4.4.198/drivers/crypto/mtk-eip93/Kconfig
```kconfig
config CRYPTO_DEV_EIP93
	tristate "Support for EIP93 crypto HW accelerators"
	depends on SOC_MT7621 || COMPILE_TEST
	help
	  EIP93 have various crypto HW accelerators. Select this if
	  you want to use the EIP93 modules for any of the crypto algorithms.
```

## release/src-ra-openwrt-4210/linux/linux-4.4.198/drivers/net/wireless/mediatek/Kconfig
```kconfig
menuconfig WL_MEDIATEK
	bool "Mediatek Wireless LAN support"
	---help---
	  Enable community drivers for MediaTek WiFi devices.
	  Those drivers make use of the Linux mac80211 stack.


if WL_MEDIATEK
source "drivers/net/wireless/mediatek/mt7601u/Kconfig"

menuconfig WIFI_DRIVER
	bool "WiFi Driver Support"

if WIFI_DRIVER

choice
	prompt "Choose First WiFi Interface"
	config FIRST_IF_NONE
	bool "None"

	config FIRST_IF_MT7615E
	bool "MT7615E"
	select WIFI_MT_MAC
	select MT_MAC
	select CHIP_MT7615E

	config FIRST_IF_MT7622
	bool "MT7622"
	select WIFI_MT_MAC
	select MT_MAC
	select CHIP_MT7622

	config FIRST_IF_MT7626
	bool "MT7626"
	select WIFI_MT_MAC
	select MT_MAC
	select CHIP_MT7626

	config FIRST_IF_MT7915
	bool "MT7915"
	select WIFI_MT_MAC
	select MT_MAC
	select CHIP_MT7915

endchoice

choice
	prompt "Choose Second WiFi Interface"
	config SECOND_IF_NONE
	bool "None"

	config SECOND_IF_MT7615E
	bool "MT7615E"
	select WIFI_MT_MAC
	select CHIP_MT7615E
	select MULTI_INF_SUPPORT

endchoice

choice
	prompt "Choose Third WiFi Interface"
	config THIRD_IF_NONE
	bool "None"

	config THIRD_IF_MT7615E
	bool "MT7615E"
	select WIFI_MT_MAC
	select CHIP_MT7615E
	select MULTI_INF_SUPPORT

endchoice

config  RT_FIRST_CARD
        int
        depends on ! FIRST_IF_NONE
	default 7615 if FIRST_IF_MT7615E
        default 7622 if FIRST_IF_MT7622
        default 7622 if FIRST_IF_MT7626
        default 7915 if FIRST_IF_MT7915

config  RT_SECOND_CARD
        int
        depends on ! SECOND_IF_NONE
        default 7615 if SECOND_IF_MT7615E

config  RT_THIRD_CARD
        int
        depends on ! THIRD_IF_NONE
        default 7615 if THIRD_IF_MT7615E

config  RT_FIRST_IF_RF_OFFSET
        hex
        depends on ! FIRST_IF_NONE
        default 0xc0000

config  RT_SECOND_IF_RF_OFFSET
        hex
        depends on ! SECOND_IF_NONE
        default 0xc8000

config  RT_THIRD_IF_RF_OFFSET
        hex
        depends on ! THIRD_IF_NONE
        default 0xd0000

if CHIP_MT7915
source "drivers/net/wireless/mediatek/mt_wifi_7915_v7400/mt_wifi/embedded/Kconfig"
endif

endif # WIFI_DRIVER
endif # WL_MEDIATEK
```

## release/src-ra-openwrt-4210/linux/linux-4.4.198/ralink/Kconfig.misc
```kconfig
menu "ASUS Miscellaneous options"

config  SINGLE_SKU_IN_DRIVER
        bool "Single sku in driver, not file"
        default n

#config  MTD_JFFS2_LEN
#        hex "MTD JFFS2 Partition Length (Unit:Bytes)"
#        default 0x0

config  MODEL_RTACRH18
        bool "RT-ACRH18"
        default n

config  MODEL_RT4GAX56
        bool "RT-4GAX56"
        default n

config  MODEL_RTAX53U
        bool "RT-AX53U"
        default n

config  MODEL_RTAX54
        bool "RT-AX54"
        default n

config  MODEL_RT4GAC86U
        bool "4G-AC86U"
        default n

config  ASUS_EXT
        bool "ASUS_EXT"
        default n

config  MTK_NAND_BLOCK2
        bool "For MTK nand using 2 block"
        default n

config  FIBOCOM_FG621
        bool "LTE module FIBOCOM FG621"
        default n

endmenu        
```

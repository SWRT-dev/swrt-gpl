## release/src-lantiq/grx500/iwlwav-driver-8.4/source/Kconfig.local
```kconfig
config BACKPORTED_BACKPORT_DIR
	tristate
	default BACKPORT_DIR
config BACKPORTED_BACKPORTS_VERSION
	tristate
	default BACKPORTS_VERSION
config BACKPORTED_BACKPORTED_KERNEL_VERSION
	tristate
	default BACKPORTED_KERNEL_VERSION
config BACKPORTED_BACKPORTED_KERNEL_NAME
	tristate
	default BACKPORTED_KERNEL_NAME
config BACKPORTED_WIRELESS
	tristate
	default WIRELESS
config BACKPORTED_NET_CORE
	tristate
	default NET_CORE
config BACKPORTED_EXPERT
	tristate
	default EXPERT
config BACKPORTED_BP_MODULES
	tristate
	default BP_MODULES
config BACKPORTED_BPAUTO_BUILD_CORDIC
	tristate
	default BPAUTO_BUILD_CORDIC
config BACKPORTED_BPAUTO_CORDIC
	tristate
	default BPAUTO_CORDIC
config BACKPORTED_BPAUTO_MII
	tristate
	default BPAUTO_MII
config BACKPORTED_BPAUTO_BUILD_LEDS
	tristate
	default BPAUTO_BUILD_LEDS
config BACKPORTED_BPAUTO_NEW_LEDS
	tristate
	default BPAUTO_NEW_LEDS
config BACKPORTED_BPAUTO_LEDS_CLASS
	tristate
	default BPAUTO_LEDS_CLASS
config BACKPORTED_BPAUTO_LEDS_TRIGGERS
	tristate
	default BPAUTO_LEDS_TRIGGERS
config BACKPORTED_BPAUTO_USERSEL_BUILD_ALL
	tristate
	default BPAUTO_USERSEL_BUILD_ALL
config BACKPORTED_BPAUTO_WANT_DEV_COREDUMP
	tristate
	default BPAUTO_WANT_DEV_COREDUMP
config BACKPORTED_BPAUTO_BUILD_WANT_DEV_COREDUMP
	tristate
	default BPAUTO_BUILD_WANT_DEV_COREDUMP
config BACKPORTED_BPAUTO_RHASHTABLE
	tristate
	default BPAUTO_RHASHTABLE
config BACKPORTED_BPAUTO_BUCKET_LOCKS
	tristate
	default BPAUTO_BUCKET_LOCKS
config BACKPORTED_BPAUTO_REFCOUNT
	tristate
	default BPAUTO_REFCOUNT
config BACKPORTED_BPAUTO_SYSTEM_DATA_VERIFICATION
	tristate
	default BPAUTO_SYSTEM_DATA_VERIFICATION
config BACKPORTED_BPAUTO_BUILD_SYSTEM_DATA_VERIFICATION
	tristate
	default BPAUTO_BUILD_SYSTEM_DATA_VERIFICATION
config BACKPORTED_BPAUTO_PUBLIC_KEY
	tristate
	default BPAUTO_PUBLIC_KEY
config BACKPORTED_BPAUTO_ASN1_DECODER
	tristate
	default BPAUTO_ASN1_DECODER
config BACKPORTED_BPAUTO_PKCS7
	tristate
	default BPAUTO_PKCS7
config BACKPORTED_WIRELESS_EXT
	tristate
	default WIRELESS_EXT
config BACKPORTED_WEXT_CORE
	tristate
	default WEXT_CORE
config BACKPORTED_WEXT_PROC
	tristate
	default WEXT_PROC
config BACKPORTED_WEXT_SPY
	tristate
	default WEXT_SPY
config BACKPORTED_WEXT_PRIV
	tristate
	default WEXT_PRIV
config BACKPORTED_CFG80211
	tristate
	default CFG80211
config BACKPORTED_NL80211_TESTMODE
	tristate
	default NL80211_TESTMODE
config BACKPORTED_CFG80211_DEVELOPER_WARNINGS
	tristate
	default CFG80211_DEVELOPER_WARNINGS
config BACKPORTED_CFG80211_CERTIFICATION_ONUS
	tristate
	default CFG80211_CERTIFICATION_ONUS
config BACKPORTED_CFG80211_REQUIRE_SIGNED_REGDB
	tristate
	default CFG80211_REQUIRE_SIGNED_REGDB
config BACKPORTED_CFG80211_USE_KERNEL_REGDB_KEYS
	tristate
	default CFG80211_USE_KERNEL_REGDB_KEYS
config BACKPORTED_CFG80211_EXTRA_REGDB_KEYDIR
	tristate
	default CFG80211_EXTRA_REGDB_KEYDIR
config BACKPORTED_CFG80211_REG_CELLULAR_HINTS
	tristate
	default CFG80211_REG_CELLULAR_HINTS
config BACKPORTED_CFG80211_REG_RELAX_NO_IR
	tristate
	default CFG80211_REG_RELAX_NO_IR
config BACKPORTED_CFG80211_DEFAULT_PS
	tristate
	default CFG80211_DEFAULT_PS
config BACKPORTED_CFG80211_DEBUGFS
	tristate
	default CFG80211_DEBUGFS
config BACKPORTED_CFG80211_CRDA_SUPPORT
	tristate
	default CFG80211_CRDA_SUPPORT
config BACKPORTED_CFG80211_WEXT
	tristate
	default CFG80211_WEXT
config BACKPORTED_CFG80211_WEXT_EXPORT
	tristate
	default CFG80211_WEXT_EXPORT
config BACKPORTED_LIB80211
	tristate
	default LIB80211
config BACKPORTED_LIB80211_CRYPT_WEP
	tristate
	default LIB80211_CRYPT_WEP
config BACKPORTED_LIB80211_CRYPT_CCMP
	tristate
	default LIB80211_CRYPT_CCMP
config BACKPORTED_LIB80211_CRYPT_TKIP
	tristate
	default LIB80211_CRYPT_TKIP
config BACKPORTED_LIB80211_DEBUG
	tristate
	default LIB80211_DEBUG
config BACKPORTED_MAC80211
	tristate
	default MAC80211
config BACKPORTED_MAC80211_HAS_RC
	tristate
	default MAC80211_HAS_RC
config BACKPORTED_MAC80211_RC_MINSTREL
	tristate
	default MAC80211_RC_MINSTREL
config BACKPORTED_MAC80211_RC_DEFAULT_MINSTREL
	tristate
	default MAC80211_RC_DEFAULT_MINSTREL
config BACKPORTED_MAC80211_RC_DEFAULT
	tristate
	default MAC80211_RC_DEFAULT
config BACKPORTED_MAC80211_MESH
	tristate
	default MAC80211_MESH
config BACKPORTED_MAC80211_LEDS
	tristate
	default MAC80211_LEDS
config BACKPORTED_MAC80211_DEBUGFS
	tristate
	default MAC80211_DEBUGFS
config BACKPORTED_MAC80211_MESSAGE_TRACING
	tristate
	default MAC80211_MESSAGE_TRACING
config BACKPORTED_MAC80211_DEBUG_MENU
	tristate
	default MAC80211_DEBUG_MENU
config BACKPORTED_MAC80211_NOINLINE
	tristate
	default MAC80211_NOINLINE
config BACKPORTED_MAC80211_VERBOSE_DEBUG
	tristate
	default MAC80211_VERBOSE_DEBUG
config BACKPORTED_MAC80211_MLME_DEBUG
	tristate
	default MAC80211_MLME_DEBUG
config BACKPORTED_MAC80211_STA_DEBUG
	tristate
	default MAC80211_STA_DEBUG
config BACKPORTED_MAC80211_HT_DEBUG
	tristate
	default MAC80211_HT_DEBUG
config BACKPORTED_MAC80211_OCB_DEBUG
	tristate
	default MAC80211_OCB_DEBUG
config BACKPORTED_MAC80211_IBSS_DEBUG
	tristate
	default MAC80211_IBSS_DEBUG
config BACKPORTED_MAC80211_PS_DEBUG
	tristate
	default MAC80211_PS_DEBUG
config BACKPORTED_MAC80211_MPL_DEBUG
	tristate
	default MAC80211_MPL_DEBUG
config BACKPORTED_MAC80211_MPATH_DEBUG
	tristate
	default MAC80211_MPATH_DEBUG
config BACKPORTED_MAC80211_MHWMP_DEBUG
	tristate
	default MAC80211_MHWMP_DEBUG
config BACKPORTED_MAC80211_MESH_SYNC_DEBUG
	tristate
	default MAC80211_MESH_SYNC_DEBUG
config BACKPORTED_MAC80211_MESH_CSA_DEBUG
	tristate
	default MAC80211_MESH_CSA_DEBUG
config BACKPORTED_MAC80211_MESH_PS_DEBUG
	tristate
	default MAC80211_MESH_PS_DEBUG
config BACKPORTED_MAC80211_TDLS_DEBUG
	tristate
	default MAC80211_TDLS_DEBUG
config BACKPORTED_MAC80211_DEBUG_COUNTERS
	tristate
	default MAC80211_DEBUG_COUNTERS
config BACKPORTED_MAC80211_STA_HASH_MAX_SIZE
	tristate
	default MAC80211_STA_HASH_MAX_SIZE
config BACKPORTED_WLAN
	tristate
	default WLAN
config BACKPORTED_WIRELESS_WDS
	tristate
	default WIRELESS_WDS
config BACKPORTED_PCMCIA_RAYCS
	tristate
	default PCMCIA_RAYCS
config BACKPORTED_PCMCIA_WL3501
	tristate
	default PCMCIA_WL3501
config BACKPORTED_MAC80211_HWSIM
	tristate
	default MAC80211_HWSIM
config BACKPORTED_USB_NET_RNDIS_WLAN
	tristate
	default USB_NET_RNDIS_WLAN
config BACKPORTED_VIRT_WIFI
	tristate
	default VIRT_WIFI
config BACKPORTED_WLAN_VENDOR_INTEL
	tristate
	default WLAN_VENDOR_INTEL
config BACKPORTED_IWLWAV
	tristate
	default IWLWAV
config BACKPORTED_IWLWAV_PLATFORM_UGW73_GRX550
	tristate
	default IWLWAV_PLATFORM_UGW73_GRX550
config BACKPORTED_IWLWAV_PLATFORM_UGW73_GRX750_PUMA_X86
	tristate
	default IWLWAV_PLATFORM_UGW73_GRX750_PUMA_X86
config BACKPORTED_IWLWAV_PLATFORM_UGW73_GRX350_A21
	tristate
	default IWLWAV_PLATFORM_UGW73_GRX350_A21
config BACKPORTED_IWLWAV_PLATFORM_UGW73_AXEPOINT
	tristate
	default IWLWAV_PLATFORM_UGW73_AXEPOINT
config BACKPORTED_IWLWAV_PLATFORM_UGW73_GRX330
	tristate
	default IWLWAV_PLATFORM_UGW73_GRX330
config BACKPORTED_IWLWAV_PLATFORM_UGW8X_GRX550
	tristate
	default IWLWAV_PLATFORM_UGW8X_GRX550
config BACKPORTED_IWLWAV_PLATFORM_YOCTO_PUMA6_X86
	tristate
	default IWLWAV_PLATFORM_YOCTO_PUMA6_X86
config BACKPORTED_IWLWAV_PLATFORM_YOCTO_PUMA7_X86
	tristate
	default IWLWAV_PLATFORM_YOCTO_PUMA7_X86
config BACKPORTED_IWLWAV_PLATFORM_YOCTO_PUMA7_X86_KERN_4_9
	tristate
	default IWLWAV_PLATFORM_YOCTO_PUMA7_X86_KERN_4_9
config BACKPORTED_IWLWAV_PLATFORM_PC_KERN_CURRENT
	tristate
	default IWLWAV_PLATFORM_PC_KERN_CURRENT
config BACKPORTED_IWLWAV_PLATFORM_PUMA_X86_YOCTO_BUILD
	tristate
	default IWLWAV_PLATFORM_PUMA_X86_YOCTO_BUILD
config BACKPORTED_IWLWAV_PLATFORM_UGW71_GRX750_PUMA_X86_UGW_BUILD
	tristate
	default IWLWAV_PLATFORM_UGW71_GRX750_PUMA_X86_UGW_BUILD
config BACKPORTED_IWLWAV_PLATFORM_LQ_UGW61_AR10_WAVE400
	tristate
	default IWLWAV_PLATFORM_LQ_UGW61_AR10_WAVE400
config BACKPORTED_IWLWAV_PLATFORM_AR10_UGW_BUILD
	tristate
	default IWLWAV_PLATFORM_AR10_UGW_BUILD
config BACKPORTED_IWLWAV_PLATFORM_PUMA_X86_UGW_BUILD
	tristate
	default IWLWAV_PLATFORM_PUMA_X86_UGW_BUILD
config BACKPORTED_IWLWAV_PLATFORM_AR10_FAMILY
	tristate
	default IWLWAV_PLATFORM_AR10_FAMILY
config BACKPORTED_IWLWAV_PLATFORM_PUMA_X86_UGW_FAMILY
	tristate
	default IWLWAV_PLATFORM_PUMA_X86_UGW_FAMILY
config BACKPORTED_IWLWAV_PLATFORM_PUMA_X86_YOCTO_FAMILY
	tristate
	default IWLWAV_PLATFORM_PUMA_X86_YOCTO_FAMILY
config BACKPORTED_IWLWAV_X86_HOST_PC
	tristate
	default IWLWAV_X86_HOST_PC
config BACKPORTED_IWLWAV_LIN_DRV
	tristate
	default IWLWAV_LIN_DRV
config BACKPORTED_IWLWAV_USE_PREBUILT_RFLIB
	tristate
	default IWLWAV_USE_PREBUILT_RFLIB
config BACKPORTED_IWLWAV_RFLIB_PATH
	tristate
	default IWLWAV_RFLIB_PATH
config BACKPORTED_IWLWAV_PMCU_SUPPORT
	tristate
	default IWLWAV_PMCU_SUPPORT
config BACKPORTED_IWLWAV_PUMA6_UDMA_SUPPORT
	tristate
	default IWLWAV_PUMA6_UDMA_SUPPORT
config BACKPORTED_IWLWAV_DC_DP_LIB_SUPPORT
	tristate
	default IWLWAV_DC_DP_LIB_SUPPORT
config BACKPORTED_IWLWAV_LINDRV_HW_PCIEG5
	tristate
	default IWLWAV_LINDRV_HW_PCIEG5
config BACKPORTED_IWLWAV_LINDRV_HW_PCIEG6
	tristate
	default IWLWAV_LINDRV_HW_PCIEG6
config BACKPORTED_IWLWAV_LINDRV_GEN6_USE_LEGACY_INT
	tristate
	default IWLWAV_LINDRV_GEN6_USE_LEGACY_INT
config BACKPORTED_IWLWAV_BUS_PCI_PCIE
	tristate
	default IWLWAV_BUS_PCI_PCIE
config BACKPORTED_IWLWAV_EEPROM_SUPPORT
	tristate
	default IWLWAV_EEPROM_SUPPORT
config BACKPORTED_IWLWAV_FORCE_USE_GENL_ENABLE
	tristate
	default IWLWAV_FORCE_USE_GENL_ENABLE
config BACKPORTED_IWLWAV_FORCE_USE_GENL_DISABLE
	tristate
	default IWLWAV_FORCE_USE_GENL_DISABLE
config BACKPORTED_IWLWAV_USE_LIBNL_NG
	tristate
	default IWLWAV_USE_LIBNL_NG
config BACKPORTED_IWLWAV_USE_INTERRUPT_POLLING
	tristate
	default IWLWAV_USE_INTERRUPT_POLLING
config BACKPORTED_IWLWAV_SET_PM_QOS
	tristate
	default IWLWAV_SET_PM_QOS
config BACKPORTED_IWLWAV_LEGACY_INT_RECOVERY_MON
	tristate
	default IWLWAV_LEGACY_INT_RECOVERY_MON
config BACKPORTED_IWLWAV_X86_PUMA7_WAVE600_NOSNOOP
	tristate
	default IWLWAV_X86_PUMA7_WAVE600_NOSNOOP
config BACKPORTED_IWLWAV_DEBUG
	tristate
	default IWLWAV_DEBUG
config BACKPORTED_IWLWAV_ENABLE_OBJPOOL
	tristate
	default IWLWAV_ENABLE_OBJPOOL
config BACKPORTED_IWLWAV_ENABLE_NBUF_OBJPOOL
	tristate
	default IWLWAV_ENABLE_NBUF_OBJPOOL
config BACKPORTED_IWLWAV_TXMM_HISTORY_LENGTH
	tristate
	default IWLWAV_TXMM_HISTORY_LENGTH
config BACKPORTED_IWLWAV_TRACER_HISTORY_LENGTH
	tristate
	default IWLWAV_TRACER_HISTORY_LENGTH
config BACKPORTED_IWLWAV_CPU_STAT
	tristate
	default IWLWAV_CPU_STAT
config BACKPORTED_IWLWAV_BENCHMARK_TOOLS
	tristate
	default IWLWAV_BENCHMARK_TOOLS
config BACKPORTED_IWLWAV_IRB_BENCHMARKING
	tristate
	default IWLWAV_IRB_BENCHMARKING
config BACKPORTED_IWLWAV_CCR_DEBUG
	tristate
	default IWLWAV_CCR_DEBUG
config BACKPORTED_IWLWAV_FW_WRITE_VALIDATION
	tristate
	default IWLWAV_FW_WRITE_VALIDATION
config BACKPORTED_IWLWAV_STAT_CNTRS_DEBUG
	tristate
	default IWLWAV_STAT_CNTRS_DEBUG
config BACKPORTED_IWLWAV_PER_PACKET_STATS
	tristate
	default IWLWAV_PER_PACKET_STATS
config BACKPORTED_IWLWAV_PRINT_PER_PACKET_STATS
	tristate
	default IWLWAV_PRINT_PER_PACKET_STATS
config BACKPORTED_IWLWAV_TSF_TIMER_TIMESTAMPS_IN_PER_PACKET_STATS
	tristate
	default IWLWAV_TSF_TIMER_TIMESTAMPS_IN_PER_PACKET_STATS
config BACKPORTED_IWLWAV_TSF_TIMER_TIMESTAMPS_IN_DEBUG_PRINTOUTS
	tristate
	default IWLWAV_TSF_TIMER_TIMESTAMPS_IN_DEBUG_PRINTOUTS
config BACKPORTED_IWLWAV_TSF_TIMER_ACCESS_ENABLED
	tristate
	default IWLWAV_TSF_TIMER_ACCESS_ENABLED
config BACKPORTED_IWLWAV_NO_FW_RESET_ON_STOP
	tristate
	default IWLWAV_NO_FW_RESET_ON_STOP
config BACKPORTED_IWLWAV_PKT_INJECT
	tristate
	default IWLWAV_PKT_INJECT
config BACKPORTED_IWLWAV_ETH_PARSER
	tristate
	default IWLWAV_ETH_PARSER
config BACKPORTED_IWLWAV_PMCU_SIMULATE_GRX330
	tristate
	default IWLWAV_PMCU_SIMULATE_GRX330
config BACKPORTED_IWLWAV_PCIE_TUNING
	tristate
	default IWLWAV_PCIE_TUNING
config BACKPORTED_IWLWAV_FILTER_BLACKLISTED_BSS
	tristate
	default IWLWAV_FILTER_BLACKLISTED_BSS
config BACKPORTED_IWLWAV_USE_MSI8_IF_AVAILABLE
	tristate
	default IWLWAV_USE_MSI8_IF_AVAILABLE
config BACKPORTED_IWLWAV_RT_LOGGER_FUNCTIONS
	tristate
	default IWLWAV_RT_LOGGER_FUNCTIONS
config BACKPORTED_IWLWAV_RT_LOGGER_INLINES
	tristate
	default IWLWAV_RT_LOGGER_INLINES
config BACKPORTED_IWLWAV_G6_BAR0_TEST
	tristate
	default IWLWAV_G6_BAR0_TEST
config BACKPORTED_IWLWAV_G6_FPGA_IRAM_TEST
	tristate
	default IWLWAV_G6_FPGA_IRAM_TEST
config BACKPORTED_IWLWAV_MAX_DLEVEL
	tristate
	default IWLWAV_MAX_DLEVEL
config BACKPORTED_IWLWAV_SILENT
	tristate
	default IWLWAV_SILENT
config BACKPORTED_IWLWAV_USE_GENL_DEF
	tristate
	default IWLWAV_USE_GENL_DEF
config BACKPORTED_IWLWAV_USE_GENL
	tristate
	default IWLWAV_USE_GENL
config BACKPORTED_IWLWAV_DEVELOPMENT_PLATFORM
	tristate
	default IWLWAV_DEVELOPMENT_PLATFORM
config BACKPORTED_IWLWAV_ENVIRONMENT_NAME
	tristate
	default IWLWAV_ENVIRONMENT_NAME
config BACKPORTED_IWLWAV_HOST_TYPE
	tristate
	default IWLWAV_HOST_TYPE
```

## release/linux/lantiq/linux-4.9/arch/mips/lantiq/Kconfig
```kconfig
if LANTIQ

config SOC_TYPE_XWAY
	bool
	select PINCTRL_XWAY
	default n

config SOC_TYPE_GRX500_TEP
	bool 
	select CEVT_R4K
	select CSRC_R4K
	select CPU_MIPSR2_IRQ_VI
	select CPU_MIPSR2_IRQ_EI
	default n

choice
	prompt "SoC Type"
	default SOC_XWAY

config SOC_AMAZON_SE
	bool "Amazon SE"
	select SOC_TYPE_XWAY

config SOC_XWAY
	bool "XWAY"
	select SOC_TYPE_XWAY
	select CEVT_R4K
	select CSRC_R4K
	select HW_HAS_PCI
	select ARCH_SUPPORTS_MSI
	select ARCH_HAS_RESET_CONTROLLER
	select RESET_CONTROLLER

config SOC_FALCON
	bool "FALCON"
	select CEVT_R4K
	select CSRC_R4K
	select PINCTRL_FALCON

config SOC_GRX500
	bool "GRX500"
	select GENERIC_ISA_DMA
	select MIPS_GIC
	select MIPS_CPU_SCACHE
	select SYS_HAS_CPU_MIPS32_R3_5
	select CPU_MIPSR2_IRQ_VI
	select CPU_MIPSR2_IRQ_EI
	select SYS_SUPPORTS_MIPS_CPS
	select SYS_SUPPORTS_MIPS_CMP
	select SYS_SUPPORTS_ZBOOT
	select SERIAL_EARLYCON if SERIAL_LANTIQ
	select HW_HAS_PCI
	select ARCH_SUPPORTS_MSI
	select ARCH_HAS_RESET_CONTROLLER
	select RESET_CONTROLLER
	select COMMON_CLK
	select CPU_SUPPORTS_CPUFREQ
	select MIPS_EXTERNAL_TIMER
	select PCI_DRIVERS_GENERIC
	select SYS_SUPPORTS_RELOCATABLE

config SOC_GRX500_BOOTCORE
	bool "GRX500_BOOTCORE"
	select SOC_TYPE_GRX500_TEP
	select SYS_SUPPORTS_RELOCATABLE

config SOC_PRX300_BOOTCORE
	bool "PRX300_BOOTCORE"
	select SOC_TYPE_GRX500_TEP
	select SYS_SUPPORTS_RELOCATABLE

endchoice

config XBAR_LE
	bool "Crossbar Word Level Little Endian Support in Big Endian CPU"
	depends on SOC_GRX500 && CPU_BIG_ENDIAN
	help
	  Falcon Mountain has complicated endianness for different datawidth.
	  To avoid too many confusion, XBAR word level little endian is added
	  So that one clean solution can be provided.
	  It will be only used if Falcon Mountain is chosen.

menu "Emulator Support"
config USE_EMULATOR
	bool "Support for FPGA emulation platform"
	default no
	help
	Use FPGA emulator as platform

choice
	prompt "Emulator"
	depends on USE_EMULATOR
	default USE_PALLADIUM

config USE_HAPS
	bool "HAPS"

config USE_PALLADIUM
	bool "Palladium"

endchoice
endmenu

choice
	prompt "Built-in device tree"
	help
	  Legacy bootloaders do not pass a DTB pointer to the kernel, so
	  if a "wrapper" is not being used, the kernel will need to include
	  a device tree that matches the target board.

	  The builtin DTB will only be used if the firmware does not supply
	  a valid DTB.

config LANTIQ_DT_NONE
	bool "None"

config DT_EASY50712
	bool "Easy50712"
	depends on SOC_XWAY
	select BUILTIN_DTB

config DT_ANYWAN
	bool "GRX500 Anywan Board"
	select BUILTIN_DTB
	depends on SOC_GRX500

config DT_EASY350550_BOOTCORE
	bool "Easy350550 Bootcore"
	select BUILTIN_DTB
	depends on SOC_GRX500_BOOTCORE

endchoice

choice
	prompt "TOS_SIZE"
	depends on SOC_TYPE_GRX500_TEP
	default TOS_SIZE_32M
config TOS_SIZE_16M
	bool "16M tos size"

config TOS_SIZE_32M
	bool "32M tos size"

config TOS_SIZE_64M
	bool "64M tos size"

config TOS_SIZE_128M
	bool "128M tos size"
endchoice

config XRX200_PHY_FW
	bool "XRX200 PHY firmware loader"
	depends on SOC_XWAY

endif
```

## release/linux/lantiq/linux-4.9/drivers/base/regmap/Kconfig
```kconfig
# Generic register map support.  There are no user servicable options here,
# this is an API intended to be used by other kernel subsystems.  These
# subsystems should select the appropriate symbols.

config REGMAP
	select IRQ_DOMAIN if REGMAP_IRQ
	tristate

config REGCACHE_COMPRESSED
	select LZO_COMPRESS
	select LZO_DECOMPRESS
	bool

config REGMAP_AC97
	tristate

config REGMAP_I2C
	tristate
	select REGMAP
	depends on I2C

config REGMAP_SPI
	tristate
	select REGMAP
	depends on SPI_MASTER
	depends on SPI

config REGMAP_SPMI
	select REGMAP
	tristate
	depends on SPMI

config REGMAP_MMIO
	tristate
	select REGMAP

config REGMAP_IRQ
	select REGMAP
	bool
```

## release/linux/lantiq/linux-4.9/drivers/clk/intel/Kconfig
```kconfig
#
# Intel Clock driver configuration
#
config COMMON_CLK_INTEL
	depends on COMMON_CLK
	select MFD_SYSCON
	bool "Intel clock controller support"

config INTEL_CLK_REGULATOR
	depends on COMMON_CLK_INTEL
	bool "Intel Clock Regulator"
	default y

	help
	  Function to only allowed reasonable clock setting

choice
	prompt "SoC platform selection"
	depends on COMMON_CLK_INTEL
	default GRX500_CLK

config PRX300_CLK
	bool "PRX300 CLK"
	help
	  Clock driver for PRX300 platform.

config GRX500_CLK
	bool "GRX500 CLK"
	help
	  Clock driver for GRX500 platform.

config GRX330_CLK
	bool "GRX330 CLK"
	help
	  Clock driver of GRX330 platform.

config GRX200_CLK
	bool "GRX200 CLK"
	help
	  Clock driver of GRX200 platform.

endchoice
```

## release/linux/lantiq/linux-4.9/drivers/dma/intel/Kconfig
```kconfig
config INTEL_CDMA
	bool "intel Central DMA0 support"
	select DMA_ENGINE
	default y
	---help---
	  Enable support for the intel central DMA controller.  This controller
	  provides DMA capabilities for a variety of on-chip devices such as SSC,
	  HSNAND and etc.

config INTEL_HDMA
	bool "Intel high performance DMA support"
	default y
	help
	  Enable support for the intel high performance DMA controller.
	  The HDMA controller supports optimized buffer copies
	  (user to kernel, kernel to kernel, etc.).  It supports
	  memcpy, p2p interface. The core is not intended for general
	  purpose slave DMA.
```

## release/linux/lantiq/linux-4.9/drivers/mtd/ltq-spinand/Kconfig
```kconfig
menuconfig MTD_LTQ_SPINAND
	tristate "Lantiq Generic SPI-Nand device support"
	depends on MTD_NAND && SPI
	help
	  Enable support for SPI NAND Flash chips on Lantiq SoCs.
	  The SPI NAND driver is still attached to NAND MTD Framework
```

## release/linux/lantiq/linux-4.9/drivers/net/datapath/Kconfig
```kconfig
# SPDX-License-Identifier: GPL-2.0

menuconfig INTEL_NP_NET_CORE
	depends on NETDEVICES
	bool "Intel NP Network device support"
	---help---
	  It contains basic network driver sets
	  required to drive INTEL NP(LGM/PRX300)
	  to support basic network packet handling.

if INTEL_NP_NET_CORE
source "drivers/net/datapath/dpm/Kconfig"
source "drivers/net/datapath/umt/Kconfig"
source "drivers/net/datapath/mib_counters/Kconfig"
source "drivers/net/datapath/pon_qos/Kconfig"
source "drivers/net/datapath/dp_eth_reinsert/Kconfig"
source "drivers/net/datapath/bridge_filter/Kconfig"
endif # INTEL_NP_NET_CORE
```

## release/linux/lantiq/linux-4.9/drivers/net/datapath/bridge_filter/Kconfig
```kconfig
if INTEL_DATAPATH

config DP_MCAST_BRIDGE_FILTER
	tristate "Datapath multicast packet bridge filter"
	depends on NETFILTER

	help
	  This installs a netfilter hook which filters out all multicast
	  packets on all bridges. These packages can then be handled in
	  user space applications.

config DP_ARP_NDP_REINSERT
	tristate "Datapath ARP and NDP packet reinsert on bridge"
	depends on NETFILTER

	help
	  This installs a netfilter hook which filters out ARP and NDP
	  packets on all bridges and reinsert them into the datapath
	  of the GSWIP again.

endif
```

## release/linux/lantiq/linux-4.9/drivers/net/datapath/dp_eth_reinsert/Kconfig
```kconfig
if INTEL_DATAPATH

config DP_ETH_REINSERT
	tristate "Datapath reinsert driver"
	depends on !GRX500_CBM
	help
	  This driver provides user space API for reinserting packets back for
	  hardware processing before sending them out. The driver provides
	  special reinsertion network devices used for the reinsertion. The
	  network device for the reinsertion point is passed using the
	  SO_MARK socket option.

endif
```

## release/linux/lantiq/linux-4.9/drivers/net/datapath/dpm/Kconfig
```kconfig
#
# Datapath Lib
#
menuconfig INTEL_DATAPATH
	bool "Datapath Manager/Core/LIB"
	default y
	depends on LTQ_CBM || INTEL_CBM
	---help---
	  Datapath Lib is to provide common rx/tx wrapper Lib without taking
	  care of much HW knowledge and also provide common interface for legacy
	  devices and different HW like to CBM or LRO.
	  Take note: All devices need to register to datapath Lib first

if INTEL_DATAPATH

config INTEL_DATAPATH_PARTIAL_FEEDS
	bool "Datapath in partial feeds"
	default y
	depends on PRX300_CQM || LGM_CQM
	---help---
	  Support dpm out of kernel tree but not fully sine some driver still 
	  calling dpm api which is built in kernel

config INTEL_DATAPATH_ACA_CSUM_WORKAROUND
	bool "ACA Checksum Workaround"
	depends on GRX500_CBM && INTEL_DATAPATH
	---help---
	  It is to solve system bus hang hang issue in GRX500
	  Once there is SW-UMT, there is no need to enable it
	  in Facon-MX and later SOC, HW bug is fixed already
	  So it should be disabled

config INTEL_DATAPATH_MANUAL_PARSE
	bool "Datapath manual parse network protocol"
	depends on GRX500_CBM && INTEL_DATAPATH
	default y
	---help---
	  Manual parse network protocol for tcp offloading
	  Only support limited tunnel yet
	  later need to enhance to support other tunnels
	  Also need to study to use network stack information

config INTEL_DATAPATH_COPY_LINEAR_BUF_ONLY
	bool "Datapath Copy linear buffer only for skb"
	depends on GRX500_CBM && INTEL_DATAPATH
	---help---
	  Datapath Copy linear buffer only for skb if need to alloc new buffer.
	  For TSO/GSO case, it will not consider
	  Make sure TSO/GSO always with enough header room to insert pmac header
	  need to enhance in the future

config INTEL_DATAPATH_DBG
	bool "Datapath Debug Tool"
	default y
	depends on INTEL_DATAPATH
	---help---
	  Datapath Debug Tool is used to provide simple debug tool
	  All other debug tools is based on it
	  Once it is disabled, all other datapath debug tool disabled.
	  By default had better enable it

config INTEL_DATAPATH_DBG_PROTOCOL_PARSE
	bool "Datapath Debug Tool for hw checksum's protocol parsing"
	depends on INTEL_DATAPATH_DBG
	---help---
	  Datapath Debug Tool for hw checksum's protocol parsing
	  Only for debugging purpose
	  By default it should be disabled.

config INTEL_DATAPATH_EXTRA_DEBUG
	bool "extra debugging support"
	depends on  INTEL_DATAPATH_DBG
	---help---
	  This is to enable/disable extra strict debugging support.
	  This is useful during initial system bring up
	  It will affect performance
	  By default it should be disabled.

config INTEL_DATAPATH_SKB
	bool "Datapath Skb Hack"
	depends on GRX500_CBM && INTEL_DATAPATH
	---help---
	  For Ethernet OAM and MPE FW purpose testing purpose,
	  It needs to hack SKB

config INTEL_DATAPATH_ETH_OAM
	bool "ETH OAM SUPPORT"
	depends on GRX500_CBM && INTEL_DATAPATH_SKB
	---help---
	  Datapath Ethernet OAM support. Once it is enabled, it will add some fields in skb structure
	  in order to support MPE FAST HOOK. The reason is that some network driver is
	  pre-build out of this build system.
	  The testing code by default is not checked in.

config INTEL_DATAPATH_SWITCHDEV
	bool "Switchdev Support"
	depends on  INTEL_DATAPATH && NET_SWITCHDEV && !GRX500_CBM
	---help---
	  Switchdev support for different switch in datapath

config INTEL_DATAPATH_CPUFREQ
	bool "Datapath DFS(COC) support"
	depends on GRX500_CBM && INTEL_DATAPATH && CPU_FREQ
	---help---
	  It is to support DFS(COC) in Datapath

config INTEL_DATAPATH_MIB
	bool "Datapath MIB support"
	depends on GRX500_CBM && INTEL_DATAPATH
	---help---
	  It is to support MIB counter in Datapath

#
# Datapath Lib
#
config LTQ_DATAPATH
	bool
	default INTEL_DATAPATH

config LTQ_DATAPATH_ACA_CSUM_WORKAROUND
	bool
	default INTEL_DATAPATH_ACA_CSUM_WORKAROUND

config LTQ_DATAPATH_SKB
	bool
	default INTEL_DATAPATH_SKB

config LTQ_DATAPATH_CPUFREQ
	bool
	default INTEL_DATAPATH_CPUFREQ

config INTEL_DATAPATH_HAL_GSWIP31
	bool "Datapath HAL"
	default y
	depends on INTEL_DATAPATH && PRX300_CQM

config INTEL_DATAPATH_QOS_HAL
	bool "Datapath HAL-QOS"
	default y
	depends on PPV4

source "drivers/net/datapath/dpm/gswip30/Kconfig"
endif
```

## release/linux/lantiq/linux-4.9/drivers/net/datapath/dpm/gswip30/Kconfig
```kconfig
menuconfig INTEL_DATAPATH_HAL_GSWIP30
	bool "Datapath HAL_GSWIP30"
	default y
	depends on INTEL_DATAPATH && GRX500_CBM
	---help---
	  Datapath Lib is to provide common rx/tx wrapper Lib without taking
	  care of much HW knowledge and also provide common interface for legacy
	  devices and different HW like to CBM or LRO.
	  Take note: All devices need to register to datapath Lib first

if INTEL_DATAPATH_HAL_GSWIP30
config INTEL_DATAPATH_HAL_GSWIP30_MIB
	bool "Datapath aggregated mib support"
	default y
	depends on INTEL_DATAPATH_HAL_GSWIP30 && SOC_GRX500 && LTQ_TMU && PPA_TMU_MIB_SUPPORT && INTEL_DATAPATH_MIB
	---help---
	  It is to aggregate GSWIP-L/R, TMU and driver's MIB counter

config INTEL_DATAPATH_MIB_TMU_MPE_MIB
        bool "Support TMU-HAL mib API and MPE_HAL mib API"
        default n
        depends on INTEL_DATAPATH_HAL_GSWIP30_MIB
        ---help---
          It is to provide TMU HAL mib api
endif
```

## release/linux/lantiq/linux-4.9/drivers/net/datapath/dpm/gswip31/Kconfig
```kconfig
menuconfig INTEL_DATAPATH_HAL_GSWIP31
	bool "Datapath HAL_GSWIP31"
	default y
	depends on INTEL_DATAPATH && PRX300_CQM
	---help---
	  Datapath Lib is to provide common rx/tx wrapper Lib without taking
	  care of much HW knowledge and also provide common interface for legacy
	  devices and different HW like to CBM or LRO.
	  Take note: All devices need to register to datapath Lib first

if INTEL_DATAPATH_HAL_GSWIP31
config INTEL_DATAPATH_HAL_GSWIP31_MIB
	bool "Datapath aggregated mib support"
	depends on INTEL_DATAPATH_HAL_GSWIP30 && SOC_GRX500 && LTQ_TMU && LTQ_PPA_TMU_MIB_SUPPORT
	default y
	---help---
	  It is to aggregate GSWIP-L/R, TMU and driver's MIB counter

config INTEL_DATAPATH_QOS_HAL
	bool "datapath QOS hal"
	default y
	depends on (LTQ_PPV4_QOS || LTQ_PPV4)
endif
```

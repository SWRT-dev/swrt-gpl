## release/linux/lantiq/linux-4.9/Documentation/devicetree/bindings/pci/intel-pcie.txt
```
* Intel AXI bus based PCI express root complex

Required properties:
- compatible:one of the following values:
	- "intel,xrx500-pcie" for GRX350/GRX550
	- "intel,prx300-pcie" for Falcon Mountain

- device_type: Must be "pci"

- #address-cells: Address representation for root ports (must be 3)
- #size-cells: Size representation for root ports (must be 2)

- reg: Register ranges as listed in the reg-names property

- reg-names: Must include the following entries
	- "csr"    Controller control and status registers
	- "cfg"    PCIe configuration space
	- "app"    Controller application register
	- "msi"    MSI phyiscal address space
	- "pic"    MSI Programmable Interrupt Controller registers

- ranges: Ranges for the PCI memory and I/O regions.

- resets: Must contain an entry for each entry in reset-names.
  See ../reset/reset.txt for details.

- reset-names: Must be "core"

- interrupt-parent: Link to its parent interrupt device.
	 Must contain "&gic" for MIPS based SoC

- interrupts: MSI interrupts and IR interrupt

- interrupt-names: must contain "msi0", "msi1", "msi2", "msi3",
		    "msi4", "msi5", "msi6", "msi7" and "ir"

- #interrupt-cells: set to <1>

- interrupt-map-mask and interrupt-map: Standard PCI IRQ mapping properties
  Please refer to the standard PCI bus binding document for a more detailed
  explanation.

- clocks: List of phandle and clock specifier pairs as listed
		    in clock-names property

- clock-names: Should contain the following entries
		- "ctrl"	Clocks the pcie controller block

- phys:List of PHY specifiers (used by generic PHY framework).

- phy-names: Must contain "phy"

- reset-gpios: gpio or ssio to PERST#

- intel,inbound-shift: Control the inbound endianess conversion. Each
	RC has unique bit to control it for some strange endpoints
- intel,outbound-shift: Control the outbound endianness conversion.
	Each RC unique bit to control it for some strange endpoints
- intel,iatu: can not decide it by detecting registers. if iatu is supported
	this field must be 1. Otherwise, must be 0
- intel,pcie-syscon: syscon interface to chiptop register to control some
	mixed functions

Optional properties:

- linux,pci-domain: PCI domain ID. Should be unique for each host controller
- num-lanes: Number of lanes to use for this port.
- max-link-speed:
   If present this property specifies PCI gen for link capability.
- bus-range: Range of bus numbers associated with this controller.
- intel,rst-interval: reset interval in ms
- intel,inbound-swap: Control inbound endianness swap
- intel,outbound-swap: control outbound endianness swap

Examples:
=========

GRX500:
--------

SoC DTSI:
	pcie0:pcie@18900000 {
		status = "disabled";
		compatible = "intel,xrx500-pcie";
		device_type = "pci";
		#address-cells = <3>;
		#size-cells = <2>;
		reg = <
			0x18900000 0x100000 /* RC controller */
			0xBB000000 0x800000 /* Cfg */
			0x18800000 0x100000 /* App logic */
			0x18600000 0x100000 /* MSI addr space */
			0x18700000 0x100000 /* MSI PIC */
		>;
		reg-names = "csr", "cfg", "app", "msi", "pic";
		linux,pci-domain = <0>;
		max-link-speed = <2>;
		bus-range = <0x00 0x08>;
		interrupt-parent = <&gic>;
		interrupts = <GIC_SHARED 128 IRQ_TYPE_EDGE_RISING>,
			<GIC_SHARED 129 IRQ_TYPE_EDGE_RISING>,
			<GIC_SHARED 130 IRQ_TYPE_EDGE_RISING>,
			<GIC_SHARED 131 IRQ_TYPE_EDGE_RISING>,
			<GIC_SHARED 132 IRQ_TYPE_EDGE_RISING>,
			<GIC_SHARED 133 IRQ_TYPE_EDGE_RISING>,
			<GIC_SHARED 134 IRQ_TYPE_EDGE_RISING>,
			<GIC_SHARED 135 IRQ_TYPE_EDGE_RISING>,
			<GIC_SHARED 152 IRQ_TYPE_LEVEL_HIGH>;
		interrupt-names = "msi0", "msi1", "msi2", "msi3", "msi4", "msi5", "msi6", "msi7", "ir";
		#interrupt-cells = <1>;
		interrupt-map-mask = <0 0 0 0x7>;
		interrupt-map = <0 0 0 1 &gic  GIC_SHARED 136 IRQ_TYPE_LEVEL_HIGH>,
				<0 0 0 2 &gic  GIC_SHARED 137 IRQ_TYPE_LEVEL_HIGH>,
				<0 0 0 3 &gic  GIC_SHARED 138 IRQ_TYPE_LEVEL_HIGH>,
				<0 0 0 4 &gic  GIC_SHARED 139 IRQ_TYPE_LEVEL_HIGH>;
		ranges = <0x02000000 0 0xb8000000 0xb8000000 0 0x03000000    /* Non-pretechable memory 32bit */
			  0x01000000 0 0xbb800000 0xbb800000 0 0x00010000    /* Downsream I/O */
			 >;

		intel,pcie-syscon = <&sysconf>;
		intel,inbound-shift = <5>;
		intel,outbound-shift = <4>;
		intel,iatu = <0>;
		clocks = <&clkgate2 GATE_PCIE0_CLK>;
		clock-names ="ctl";
		phys = <&pcie_phy0>;
		phy-names = "phy";
	};

Board DTS:

	&pcie0 {
		status = "okay";
		intel,rst-interval = <200>;
		intel,inbound-swap = <1>;
		intel,outbound-swap = <0>;
		reset-gpio = <&gpio0 18 0>;
	};

PRX300:
--------
SoC DTSI:

	pcie0:pcie@1a400000 {
		compatible = "intel,prx300-pcie";
		device_type = "pci";
		#address-cells = <3>;
		#size-cells = <2>;
		reg = <
			0x1a400000 0x1000 /* RC controller */
			0xbb000000 0x800000 /* Cfg */
			0x1a341000 0x1000 /* App logic */
			0x1a100000 0x100 /* MSI addr space */
			0x1a200000 0x100 /* MSI PIC */
		>;
		reg-names = "csr", "cfg", "app", "msi", "pic";
		linux,pci-domain = <0>;
		max-link-speed = <3>;
		bus-range = <0x00 0x08>;
		interrupt-parent = <&gic>;
		interrupts = <GIC_SHARED 128 IRQ_TYPE_EDGE_RISING>,
			<GIC_SHARED 129 IRQ_TYPE_EDGE_RISING>,
			<GIC_SHARED 130 IRQ_TYPE_EDGE_RISING>,
			<GIC_SHARED 131 IRQ_TYPE_EDGE_RISING>,
			<GIC_SHARED 132 IRQ_TYPE_EDGE_RISING>,
			<GIC_SHARED 133 IRQ_TYPE_EDGE_RISING>,
			<GIC_SHARED 134 IRQ_TYPE_EDGE_RISING>,
			<GIC_SHARED 135 IRQ_TYPE_EDGE_RISING>,
			<GIC_SHARED 152 IRQ_TYPE_LEVEL_HIGH>;
		interrupt-names = "msi0", "msi1", "msi2", "msi3", "msi4", "msi5", "msi6", "msi7", "ir";
		#interrupt-cells = <1>;
		interrupt-map-mask = <0 0 0 0x7>;
		interrupt-map = <0 0 0 1 &gic  GIC_SHARED 136 IRQ_TYPE_LEVEL_HIGH>,
				<0 0 0 2 &gic  GIC_SHARED 137 IRQ_TYPE_LEVEL_HIGH>,
				<0 0 0 3 &gic  GIC_SHARED 138 IRQ_TYPE_LEVEL_HIGH>,
				<0 0 0 4 &gic  GIC_SHARED 139 IRQ_TYPE_LEVEL_HIGH>;
		ranges = <0x02000000 0 0xb8000000 0xb8000000 0 0x03000000    /* Non-pretechable memory 32bit */
			  0x01000000 0 0xbb800000 0xbb800000 0 0x00010000     /* Downsream I/O */
			 >;
		resets = <&rcu0 22>;
		reset-names =  "core";
		intel,pcie-syscon = <&sysconf>;
		intel,inbound-shift = <6>;
		intel,outbound-shift = <4>;
		intel,iatu = <1>;
		clocks = <&clkgate2 GATE_CTRL0_CLK>;
		clock-names ="ctl";
		phys = <&cb0phy0>;
		phy-names = "phy";
	};

Board DTS:

	&pcie0 {
		intel,rst-interval = <200>;
		intel,inbound-swap = <1>;
		intel,outbound-swap = <0>;
		reset-gpio = <&ssogpio 18 0>;
		num-lanes = <2>;
	};
```

## release/linux/lantiq/linux-4.9/Documentation/devicetree/bindings/phy/phy-intel-wan-xpcs.txt
```
Intel WAN XPCS PHY controller

This file documents the dt bindings for the WAN XPCS PHY

Required properties:
- compatible	: should be "intel,wanxpcsphy-prx300"
- clocks	: frequency clock.
		  Optionally we can include gate clock
- clock-names	: should be "freq".
		  Optionally we can include "xpcs" and "hwclken" for gate clock
- clock-frequency	: frequency of pll3. This is necessary so that clk
			  framework can select the correct parent
- #phy-cells	: should be <0>
- intel,wanxpcsphy-syscon	: phandle to sysconf chiptop
- resets	: list of phandle and reset specifier pairs.
- reset-names	: list of reset signal names. Should be "phy".
		  See: Documentation/devicetree/bindings/reset/reset.txt

Note that WAN XPCS and PON are exclusive; one must be disabled to use the other
one.

Example:

wan_xpcs_phy: phy {
	compatible = "intel,wanxpcsphy-prx300";
	clocks = <&ponclk>, <&clkgate1 GATE_AON_CLK>, <&clkgate3 GATE_SW_REF>;
	clock-names = "freq", "xpcs", "hwclken";
	clock-frequency = <156250000>;
	#phy-cells = <0>;
	status = "okay";
	resets = <&rcu0 10>;
	reset-names = "phy";
	intel,wanxpcsphy-syscon = <&sysconf>; /* chiptop */
};

Example to use this phy in driver:

test_driver@0 {
	...
	phys = <&wan_xpcs_phy>;
	phy-names = "wan_xpcs"
}
```

## release/linux/lantiq/linux-4.9/Documentation/devicetree/bindings/regulator/tps65273.txt
```
Texas Instruments TPS65273 power regulator

The TPS65273V is a monolithic dual synchronous buck regulator with wide 4.5V
to 18-V operating input voltage. It has external feedback resistors that can
be used for setting the initial start up voltage. The output voltage in each
buck can be programmable from 0.68 V to 1.95 V in 10-mV steps with I2C
Controlled 7-Bits VID.

Two bucks in TPS65273V can be paralleled to deliver up to 10-A load current by
floating the MODE pin.


Required properties:

- compatible: "ti,tps65273"
- reg: I2C slave address
- regulators: A node that houses a sub-node for each regulator within the
  device. The tps65273V is a dual-synchronous DC-DC so it will create
  two regulator devices on the system. Each sub-node is identified using
  the node's name, with valid values listed below. The content of each
  sub-node is defined by the standard binding for regulators found at
  Documentation/devicetree/bindings/regulator/regulator.txt

  The valid names for regulators are: dcdc1, dcdc2


Optional properties:

- vout_slew_rate: programmable slew rate control for output voltage.
- vout_psm_mode: Pulse Skipping Mode to achieve high efficiency in light load.


Example:

tps:tps65273@62 {
	compatible = "ti,tps65273";
	reg = <0x62>;

	regulators {
		buck1_reg: BUCK1 {
			regulator-name = "1V15VDD";
			regulator-always-on;
			regulator-boot-on;
			regulator-min-microvolt = <900000>;
			regulator-max-microvolt = <1200000>;
			regulator-microvolt-offset = <0>;
			vout-slew-rate = <0>;
			vout-psm-mode  = <0>;
		};

		buck2_reg: BUCK2 {
			regulator-name = "2V15VDD";
			regulator-min-microvolt = <900000>;
			regulator-max-microvolt = <1200000>;
			regulator-microvolt-offset = <0>;
			vout-slew-rate = <0>;
			vout-psm-mode  = <0>;
		};
	};
};
```

## release/linux/lantiq/linux-4.9/Documentation/devicetree/bindings/regulator/virtual-consumer-platdev.txt
```
Voltage/Current Regulator Virtual Consumer

Virtual consumer driver is mainly supposed to be used for debug and test
purposes. It gives a posibility to control a regulator voltage/current from
userspace.

The bindings below helps to define a dummy platform device in device tree and
bind the virtual consumer with a regulator you want to test.

Properties:
  - compatible: must be "intel,reg-virt-platdev"
  - regulator: a phandle to existing regulator node.


Example:

reg-virt-consumer: {
	compatible = "intel,reg-virt-platdev";
	regulator = <$buck1_reg>;
};

reg-virt-consumer2: {
	compatible = "intel,reg-virt-platdev";
	regulator = <$buck2_reg>;
};
```

## release/linux/lantiq/linux-4.9/Documentation/devicetree/bindings/reset/intel,syscon-reset.txt
```
Intel System Reset Controller
======================================

Please also refer to reset.txt in this directory for common reset
controller binding usage.

The reset controller registers are RCU module on Intel GRX500/PRX300 SoC.

Required properties:
- compatible: should be
		 "lantiq,rcu-grx500"
- reg:	should be register base and size for this reset controller
- #reset-cells : must be 2. type should be a <u32>

	 Cell #1 : offset of the reset assert control
	           register from the syscon register base
		   offset + 4: status control register
	 Cell #2 : bit offset in the reset request control register
-intel,global-reset: offset and bit offset of global reset
	in the reset controller that can be used in system reboot.

Example:
	rcu0: reset-controller@00000000 {
		compatible = "lantiq,rcu-grx500", "syscon";
		reg = <0x000000 0x80000>;
		#reset-cells = <2>;
		intel,global-reset = <0x10 30>;
	};


Specifying reset lines connected to IP modules
==============================================
example:
	pcie_phy0: pciephy@.... {
		....
		resets = <&rcu0 0x10 12>; /* address offset: 0x10, bit offset: 12 */
		....
	};
```

## release/linux/lantiq/linux-4.9/Documentation/devicetree/bindings/thermal/ltq-thermal.txt
```
* Thermal Sensor for Lantiq SoCs

These are the bindings for Lantiq GRX500/XRX500 on-SoC thermal sensor. It's
not irq driven sensor so it needs thermal zone definition (see example below)
to poll the sensor periodically.

Required properties:
- compatible:
  - "lantiq,ts-xrx500" for Lantiq GRX500 SoC
  - "intel,ts-prx300" for prx300 SoC

- intel,syscon: phandle to syscon node


Example of sensor definition:

ts: ts@080000 {
	#thermal-sensor-cells = <0>;

	compatible = "lantiq,ts-xrx500";
	intel,syscon = <&sysconf>;
};


Example of thermal zone definition:

thermal-zones {
	cpu_thermal: cpu-thermal {
		polling-delay-passive = <500>; /* milliseconds */
		polling-delay = <1000>; /* milliseconds */

		thermal-sensors = <&ts>;

		trips {
			cpu_alert0: cpu-alert0 {
				temperature = <65000>; /* millicelsius */
				hysteresis = <2000>; /* millicelsius */
				type = "passive";
			};
			cpu_alert1: cpu-alert1 {
				temperature = <100000>; /* millicelsius */
				hysteresis = <10000>; /* millicelsius */
				type = "passive";
			};
			cpu_crit: cpu-crit {
				temperature = <125000>; /* millicelsius */
				hysteresis = <10000>; /* millicelsius */
				type = "critical";
			};
		};

		cooling-maps {
			map0 {
				trip = <&cpu_alert0>;
				cooling-device = <&cpu0 THERMAL_NO_LIMIT 1>;
			};
			map1 {
				trip = <&cpu_alert1>;
				cooling-device = <&cpu0 2 THERMAL_NO_LIMIT>;
			};
		};
	};
};
```

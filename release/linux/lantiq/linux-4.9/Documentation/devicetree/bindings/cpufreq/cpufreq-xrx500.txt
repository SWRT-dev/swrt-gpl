## release/linux/lantiq/linux-4.9/Documentation/devicetree/bindings/cpufreq/cpufreq-xrx500.txt
```
Binding for Intel's XRX500 SoC CPUFreq driver
==============================================

XRX500 SoC CPUFreq driver reads CHIPID and supplies the OPP framework with
'supported hardware' property. This is the only addition to standard OPP
description.

For more information about the expected DT format [See: ../opp/opp.txt].

- opp-supported-hw:	use single version hierarchy. Supported versions:

			SOC_HW_ID_GRX5838	0x1
			SOC_HW_ID_GRX5828	0x2
			SOC_HW_ID_GRX5628	0x4
			SOC_HW_ID_GRX5821	0x8
			SOC_HW_ID_GRX5831	0x10
			SOC_HW_ID_GRX58312	0x20
			SOC_HW_ID_GRX3506	0x40
			SOC_HW_ID_GRX3508	0x80
			SOC_HW_ID_IRX200	0x100

Example
-------

cpus {
	cpu@0 {
		operating-points-v2	= <&cpu_opp_table>;
	};
};

cpu_opp_table: opp_table {
	compatible = "operating-points-v2";
	opp-shared;

	opp@1000000000 {
		opp-hz = /bits/ 64 <1000000000>;
		opp-supported-hw = <0x00000010>;
		opp-microvolt-slow_default = <1100000>;
		opp-microvolt-not_defined = <1100000>;
		opp-microvolt-slow0 = <1100000>;
		opp-microvolt-slow1 = <1100000>;
		opp-microvolt-slow2 = <1100000>;
		opp-microvolt-slow3 = <1150000>;
		opp-microvolt-typ0  = <1050000>;
		opp-microvolt-typ1  = <1100000>;
		opp-microvolt-typ2  = <1050000>;
		opp-microvolt-typ3  = <1050000>;
		opp-microvolt-fast0 = <1000000>;
		opp-microvolt-fast1 = <1050000>;
		opp-microvolt-fast2 = <1150000>;
		opp-microvolt-fast3 = <1150000>;
		};

	opp@800000000 {
		opp-hz = /bits/ 64 <800000000>;
		opp-supported-hw = <0xffffffff>;
		opp-microvolt-slow_default = <1100000>;
		opp-microvolt-not_defined = <1100000>;
		opp-microvolt-slow0 = <1100000>;
		opp-microvolt-slow1 = <1100000>;
		opp-microvolt-slow2 = <1100000>;
		opp-microvolt-slow3 = <1150000>;
		opp-microvolt-typ0  = <1050000>;
		opp-microvolt-typ1  = <1100000>;
		opp-microvolt-typ2  = <1050000>;
		opp-microvolt-typ3  = <1050000>;
		opp-microvolt-fast0 = <1000000>;
		opp-microvolt-fast1 = <1050000>;
		opp-microvolt-fast2 = <1150000>;
		opp-microvolt-fast3 = <1150000>;
	};
};
```

## release/linux/lantiq/linux-4.9/Documentation/devicetree/bindings/net/intel,falconmx-bm.txt
```
Intel PRX300 BM driver Device Tree Bindings
-------------------------------------------------------------

 - compatible:          "intel,prx300-bm"
 - reg:                 TODO:

Examples:

bm@0 {
        compatible = "intel,prx300-bm";
        reg = <0x00>;
};
```

## release/linux/lantiq/linux-4.9/Documentation/devicetree/bindings/net/intel,prx300-cqm.txt
```
* PRX CQM

Required properties:
- compatible:	should be "intel,prx300-cqm"
- reg:	address and length of the register set for the device.
- interrupts:	IRQ line info for CQM The interrupt specifier
	depends on the interrupt-parent interrupt controller
- interrupt-names:	Name associated with interrupt line
- clocks: clocks source for CQM
- clocks:-names: name of the clock source
- resets:	reference to a reset controller asserting the CQM
- reset-names:	list of reset signal names.
          See: Documentation/devicetree/bindings/reset/reset.txt
- intel,syscon: reference to syscon
- intel,bm-buff-size: reference to buffer pool size
- intel,bm-buff-num: bm buffer numbers for pool 0 - 3
- intel,bm-buff-num-a1: A1 bm buffer numbers for pool 0 - 3
- intel,bm-buff-num-a1: A1 bm buffer size for pool 0 - 3
- intel,re-insertion: enable/disable re-insertion handling
	0 - re_insertion disabled
	1 - re_insertion enabled
- intel,deq-port: cpu deq port configuration, to specify port num and port type

Optional properties:
- intel,radio-32-vap: number of radios requiring 32 VAP support defined
		      in policy_defs
		0 - not supporting radio port
		1 - 1 radio
		2 - 2 radios

Example:
	cqm: cqm@A40000 {
		compatible = "intel,prx300-cqm";
		reg = < 0xA40000 0x10000 /*TX PUSH DQM*/
			0xF00000 0x100000   /*CQM DMA DESC*/
			0x1010000 0x10000 /*CQM*/
			0x1020000 0x4000 /*QIDT*/
			0x1060000 0x10000 /*LS*/
			0x1080000 0x20000 /*CQM ENQ*/
			0x10C0000 0x40000 /*CBM DEQ*/
			0x1140000 0x400 /*QID2EP_MAP*/
			0x1200000 0x100000 /*FSQM*/
			0x1100000 0x1000 /*CQEM PIB*/
			0x1141000 0x100 /*CBM PON CNTR*/
			>;
		interrupt-parent = <&gic>;
		interrupts = <GIC_SHARED 192 IRQ_TYPE_LEVEL_HIGH>,
			     <GIC_SHARED 196 IRQ_TYPE_LEVEL_HIGH>,
			     <GIC_SHARED 197 IRQ_TYPE_LEVEL_HIGH>,
			     <GIC_SHARED 198 IRQ_TYPE_LEVEL_HIGH>,
			     <GIC_SHARED 199 IRQ_TYPE_LEVEL_HIGH>;
		resets = <&rcu0 0x10 8>;
		reset-names = "cqm";
		clocks = <&cgu0 PRX300_CLK_NGI>, <&cgu0 PRX300_GCLK_CQEM>;
		clock-names = "freq", "cbm";
		intel,syscon = <&sysconf>;
		/* Total Number of Buffers in pools 0-3 */
		intel,bm-buff-num = <0x4480 0x680 0x13100 0x1a80>;
		/* Size of each buffer in pools 0-3 */
		intel,bm-buff-size = <0x400 0x2800 0x400 0x2800>;
		/* Applicable only for A1 chip */
		/* Total Number of Buffers in pool0 */
		intel,bm-buff-num-a1 = <0xaf40>;
		/* Size of each buffer in pool0 */
		intel,bm-buff-num-a1 = <0x1000>;
		/* split the buffer pools into 2 for DS and 2 for US */
		intel,bm-buff-split = <0x2 0x2>;
		intel,re-insertion = <1>;
		intel,radio-32-vap = <1>;
		/*
		* DQ port,
		* intel,deq-port = <port_num port_type>
		* port_type = 2 for CPU
		* port_type = 4 for MPE FW(if available)
		*/
		DQ0: cpu-port0 {
				intel,deq-port = <0 2>;
		};
	};
```

## release/linux/lantiq/linux-4.9/Documentation/devicetree/bindings/net/intel-xpcs.txt
```
* Intel XPCS driver

Required properties:
- compatible:	should be "intel,xpcs"
- reg:	address and length of the register set for the device.
- reg-names:	names of the mapped memory regions listed in regs property
- interrupts:	IRQ line info for XPCS, The interrupt specifier
	depends on the interrupt-parent interrupt controller
- interrupt-names:	Name associated with interrupt line
	Should be "xpcs_reset"
- phy: - phys :	the phandle for the PHY device
	(used by generic PHY framework)
- phy-names :	the names of the PHY corresponding to the PHYs present in the
  	 *phy* phandle.
- resets:	Reference to a reset controller asserting the XPCS
- reset-names:	list of reset signal names. Should be "xpcs_reset".
          See: Documentation/devicetree/bindings/reset/reset.txt
-xpcs-mode:	Speed capabilities of the XPCS
	 0 - 10GbE-KR(default)
	 1 - 10GbE-XAUI
	 2 - 1GbE-SGMII
	 3 - 2.5GbE-SGMII
xpcs-cl73:	CL73 configuration
	0 - CL73 ANEG disabled
	1 - CL73 ANEG enabled
xpcs-cl37:	CL37 configuration
	0 - CL37 ANEG disabled
	1 - CL37 ANEG enabled in SGMII MAC Side
	2 - CL37 ANEG enabled in SGMII PHY Side
	3 - CL37 ANEG enabled (BaseX)
xpcs-conn:	Auto negotiate mode (for backward compatible)
	0 - disable ANEG, overwritten by xpcs-cl37/xpcs-cl73
	1 - enable ANEG, overwritten by xpcs-cl37/xpcs-cl73
power-save:	Tx current boost level on lane of the PHY
	0 - Default Value
	1 - 0xB

Optional properties:
- xpcs-no-phy-rx-auto-adapt: boolean,Tunes the phy hw
	parameters for current configuration.
 
xpcs_mode_cfg_seq:  management of link dynamically,
			represented by an array with each value corresponding
			to a particular speed supported options are
		0 - 10GbE-KR(default)
		1 - 10GbE-XAUI
		2 - 1GbE-SGMII (1000BaseX)
		3 - 2.5GbE-SGMII (2500BaseX)

link_poll_interval: polling period of XPCS get link status.

The following optional Channel Equalization properties are
represented by an array with each value corresponding to a
particular speed. The first array value represents the setting
for the 10GbE KR speed, the second value for the 10GbE XAUI, the second
value for the 2.5GbE speed and the fouth value for the 10GbE speed.
All four values are required if the property is used.

/* xpcs RX EQ Settings */
-xpcs-afe_en: Rx Adaptation AFE Enable on lane
-xpcs-dfe_en: Rx Decision Feedback Equalization (DFE) Enable on lane
-xpcs-cont_adapt_en: Receiver Adaptation Continuous Operation on lane
-xpcs-rx_attn_lvl: Rx Equalization Attenuation level for lane
-xpcs-rx_ctle_boost: Rx Equalization CTLE Boost value on lane
-xpcs-rx_ctle_pole: Rx Equalization CTLE Pole Value on lane
-xpcs-rx_vga2_gain:Rx Equalization VGA2 Gain on lane
-xpcs-rx_vga1_gain: Rx Equalization VGA1 Gain on lane

/* xpcs TX EQ Settings */
-xpcs-tx_eq_pre: Tx Pre-Emphasis level adjustment Control
-xpcs-tx_eq_post: Tx Post-Emphasis level adjustment Control
-xpcs-tx_eq_main: Control for setting Tx driver output amplitude
-xpcs-tx_iboost_lvl: Tx current boost level on lane
-xpcs-tx_vboost_lvl: Tx Voltage Boost Maximum Level
-xpcs-tx_vboost_en: Tx voltage Boost Enable on lane 

Example:
	wan_xpcs: wan_xpcs@18C42000 {
		compatible = "intel,xpcs";
		reg =<0x18C42000 0x400 >;
		reg-names = "xpcs_reg";
		interrupt-parent = <&gic>;
		interrupts = <GIC_SHARED 26 IRQ_TYPE_LEVEL_HIGH>;
		interrupt-names = "xpcs_irq";
		phys = <&wan_xpcs_phy>;
		phy-names = "phy";
		resets = <&rcu0 0x10 16>;
		reset-names = "xpcs_reset";
		xpcs-name = "wan_xpcs";
		xpcs-mode = <2>;
		xpcs-cl73 = <0>;
		xpcs-cl37 = <1>;
		power-save = <1>;
		xpcs-no-phy-rx-auto-adapt
		/* xpcs RX EQ Settings */
		xpcs-afe_en = <0x0>, <0x0>, <0x0>, <0x0>;
		xpcs-dfe_en = <0x0>, <0x0>, <0x0>, <0x0>;
		xpcs-cont_adapt_en = <0x0>, <0x0>, <0x0>, <0x0>;
		xpcs-rx_attn_lvl = <0x7>, <0x7>, <0x7>, <0x7>;
		xpcs-rx_ctle_boost = <0x0>, <0x0>, <0x0>, <0x0>;
		xpcs-rx_ctle_pole = <0x6>, <0x6>, <0x6>, <0x6>;
		xpcs-rx_vga2_gain = <0x5>, <0x5>, <0x5>, <0x5>;
		xpcs-rx_vga1_gain = <0x5>, <0x5>, <0x5>, <0x5>;
		/* xpcs TX EQ Settings */
		xpcs-tx_eq_pre = <0x5>, <0x5>, <0x0>, <0x0>;
		xpcs-tx_eq_post =  <0x14>, <0x14>, <0x1>, <0x1>;
		xpcs-tx_eq_main = <0x18>, <0x18>, <0xC>, <0xC>;
		xpcs-tx_iboost_lvl = <0xF>, <0xF>,<0xF>, <0xF>;
		xpcs-tx_vboost_lvl = <0x5>, <0x5>, <0x5>, <0x5>;
		xpcs-tx_vboost_en = <0x1>, <0x1>, <0x1>, <0x1>;
	}
```

## release/linux/lantiq/linux-4.9/Documentation/devicetree/bindings/net/lantiq,phy-xrx500.txt
```
Intel/Lantiq GPHY firmware loader

This file documents the dt bindings for the Intel/Lantiq GPHY firmware
loader, currently used in xrx500 and prx300 platform.

Required properties:
- compatible	: "lantiq,phy-xrx500" for xrx500 platform
		  "intel,phy-prx300" for prx300 platform
- firmware	: firmware file name
- reg		: register address
- resets	: list of phandle and reset specifier pairs.
- reset-names	: list of reset signal names.
  Reset and reset names are platform specific

For prx300 platform:
- intel,syscon	: phandle to syscon chiptop
- intel,cgu-syscon	: phandle to syscon cgu

Example:

phy_fw: phy-xrx500@3c00 {
	compatible = "lantiq,phy-xrx500";
	reg = <0x3c00 0x400>;
	firmware = "ltq_fw_PHY11G_IP_xRx5xx_A21.bin";
	resets = <&rcu0 0x10 29>, <&rcu0 0x10 28>,
		 <&rcu0 0x10 26>, <&rcu0 0x10 25>,
		 <&rcu0 0x10 31>;
	reset-names = "phy0", "phy1", "phy2", "phy3", "phy4";
};

phy_fw: phy-prx300@210100 {
	compatible = "intel,phy-prx300";
	reg = <0x210100 0x10>;
	firmware = "ltq_fw_PHY31G_IP_prx3xx_A11.bin";
	resets = <&rcu0 0x10 29>, <&rcu0 0x48 28>,
		 <&rcu0 0x48 27>;
	reset-names = "gphy", "gphy_cdb", "gphy_pwr_down";
	intel,syscon = <&sysconf>; /* chiptop */
	intel,cgu-syscon = <&cgu0>;
};
```

## release/linux/lantiq/linux-4.9/Documentation/devicetree/bindings/net/lantiq,pon.txt
```
Intel PON Ethernet driver Device Tree Bindings
-------------------------------------------------------------

 - compatible:		"lantiq,falcon-mountain-pon"
 - reg:			TODO:

Examples:

pon@0 {
	compatible = "lantiq,falcon-mountain-pon";
	reg = <0x00>;
};
```

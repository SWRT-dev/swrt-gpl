## release/linux/lantiq/linux-4.9/drivers/net/datapath/dpm/gswip32/Kconfig
```kconfig
menuconfig INTEL_DATAPATH_HAL_GSWIP32
	bool "Datapath HAL_GSWIP32"
	default y
	depends on INTEL_DATAPATH && X86_INTEL_LGM
	---help---
	  Datapath Lib is to provide common rx/tx wrapper Lib without taking
	  care of much HW knowledge and also provide common interface for legacy
	  devices and different HW like to CBM or LRO.
	  Take note: All devices need to register to datapath Lib first

if INTEL_DATAPATH_HAL_GSWIP32
config INTEL_DATAPATH_HAL_GSWIP32_MIB
	bool "Datapath aggregated mib support"
	default n
	---help---
	  It is to aggregate GSWIP-O, PP and driver's MIB counter

config INTEL_DATAPATH_HAL_GSWIP32_CPUFREQ
	bool "Datapath DFS(COC) support"
	depends on INTEL_DATAPATH && LTQ_CPUFREQ && LTQ_ETHSW_API
	default y
	---help---
	  It is to support DFS(COC) in Datapath

config INTEL_DATAPATH_QOS_HAL
	bool "datapath QOS hal"
	default y
	depends on PPV4 || LTQ_PPV4
endif
```

## release/linux/lantiq/linux-4.9/drivers/net/datapath/mib_counters/Kconfig
```kconfig
# SPDX-License-Identifier: GPL-2.0

config INTEL_MIB_COUNTERS
    bool "MIB counters driver"
    default y
    depends on INTEL_DATAPATH && !GRX500_CBM

    ---help---
    This driver supports counters overflow handling.
    It is designed to accumulate 32 bit wide counters
    into 64 bit counters and overflow handling
```

## release/linux/lantiq/linux-4.9/drivers/net/datapath/pon_qos/Kconfig
```kconfig
# SPDX-License-Identifier: GPL-2.0

config PON_QOS
	tristate "PON QoS driver"
	depends on INTEL_DATAPATH && !GRX500_CBM
	select NET_SCH_RED
	select NET_ACT_COLMARK

	help
	  This driver provides user space API for configuring PON specific QoS
	  resources as schedulers, queues etc. The interface is based on linux
	  tc offload interface. The Intel datapath driver is used to do the
	  actual hardware configuration.

config PON_QOS_KCOV
	bool "PON QoS KCOV"
	depends on KCOV && PON_QOS
	help
	  Enable coverage on PON QoS driver for fuzzing.

config PON_QOS_TRACING
	bool "PON QoS tracing support"
	depends on PON_QOS
	depends on EVENT_TRACING
	---help---
	  Select this to enable pon_qos tracing infrastructure.
```

## release/linux/lantiq/linux-4.9/drivers/net/datapath/umt/Kconfig
```kconfig
# SPDX-License-Identifier: GPL-2.0

config INTEL_UMT
	bool "User message transfer driver"
	depends on INTEL_DATAPATH

	help
	  This driver supports Intel UMT Hardware.
	  UMT HW is designed to work with CQM HW to
	  send the RX/TX counter to PCIe Endpoint.
```

## release/linux/lantiq/linux-4.9/drivers/net/ethernet/lantiq/Kconfig
```kconfig
config NET_VENDOR_LANTIQ
        bool "Lantiq network devices"
        default y
        depends on  SOC_XWAY || SOC_GRX500
        ---help---
          If you have a network (Ethernet) card belonging to this class, say Y
          and read the Ethernet-HOWTO, available from
          <http://www.tldp.org/docs.html#howto>.

if NET_VENDOR_LANTIQ

config LANTIQ_VRX318
	tristate "VRX318 SmartPHY PCIe EP driver"
	depends on PCIE_LANTIQ
	default n
	---help---
	Supported VRX318 smartPHY PCIe EP

config LANITQ_VRX318_PCIE_SWITCH_DSL_BONDING
	tristate "VRX318 SmartPHY DSL bonding with PCIe Switch"
	depends on LANTIQ_VRX318
	default n
	---help---
	Supported VRX318 smartPHY PCIe DSL Bonding with PCIe switch

config LANTIQ_ETH_FRAMEWORK
	bool "Lantiq framework for ethernet drivers"
	depends on LANTIQ
	default n
	---help---
	Lantiq framework for ethernet drivers

config LTQ_ETH_XRX500
        tristate "Lantiq Ethernet driver for XRX500 series"
        depends on LANTIQ && SOC_GRX500 && LTQ_ETHSW_API && (LTQ_CBM || LTQ_DATAPATH_LIBRARY)
        default n
        ---help---
        Lantiq Ethernet driver for XRX500 series.

config INTEL_PON_HGU_VUNI 
        tristate "Intel PON HGU vUNI driver"
        depends on (LTQ_DATAPATH || PRX300_CQM)
        ---help---
        Intel PON HGU vUNI driver.

config INTEL_GINT_ETH
        tristate "INTEL G.INT Ethernet driver"
        depends on (LTQ_DATAPATH || PRX300_CQM)
        default n
        ---help---
        INTEL G.INT Ethernet driver.

config XRX500_ETH_DRV_THERMAL_SUPPORT
	bool "ThermaL support in the ethernet driver"
	depends on LTQ_ETH_XRX500 && THERMAL
	---help---
	Thermal support in the Ethernet driver of XRX500 series

config SW_ROUTING_MODE
        bool "Enable the SW routing mode in ethernet driver"
	depends on LTQ_ETH_XRX500
	default y
        ---help---
        Lantiq Ethernet driver routing mode

config HAPS_CPU_LOOPBACK_TEST 
        bool "Enable CPU enqueue and dequeue loopback"
	depends on LTQ_ETH_XRX500
	default n
        ---help---
        Lantiq Ethernet driver CPU Enqueue and Dequeue test

config XRX500_PHY_FW
	tristate "XRX500 PHY firmware loader"
	depends on SOC_GRX500
	default n
        ---help---
        GPHY FW loader on GRX500 platforms

config INTEL_UMT_CQEM_MODE
        bool "Intel UMT in CQEM mode"
        depends on PRX300_CQM
        help
          In cqem mode, UMT (User Message Transfer) HW
          is able to support max three UMT port.
          CBM port and DMA channels that associated with
          the UMT port can be configurable.

config LTQ_TOE_DRIVER
	bool "Enable the TOE (TCP Offload Engine) driver for XRX500"
        depends on LTQ_ETH_XRX500
        default n
        ---help---
        Lantiq TOE (TCP Offload Engine) driver for XRX500 series.

config INTEL_XPCS
	tristate "Intel XPCS driver support"
        select GENERIC_PHY
	---help---
	  This driver provides support for Xpcs for 10G.


source "drivers/net/datapath/Kconfig"
source "drivers/net/ethernet/lantiq/e160/Kconfig"
source "drivers/net/ethernet/lantiq/switch-api/Kconfig"
source "drivers/net/ethernet/lantiq/cqm/Kconfig"
source "drivers/net/ethernet/lantiq/tmu/Kconfig"
source "drivers/net/ethernet/lantiq/ppa/Kconfig"
source "drivers/net/ethernet/lantiq/qos_mgr/Kconfig"
source "drivers/net/ethernet/lantiq/directconnect_dp/Kconfig"
endif # NET_VENDOR_LANTIQ
```

## release/linux/lantiq/linux-4.9/drivers/net/ethernet/lantiq/cqm/Kconfig
```kconfig
#
# Central QOS Manager(CQM) configuration
#
config LTQ_CBM
	bool "Central Buffer Manager Driver"
	depends on SOC_GRX500
	default n

	---help---
	Turn on this option to enable CBM/CQM driver which is a special hardware
	present in the XRX500/FALCONMX series of SoCs to manage the network buffers
	in HW.

choice
	prompt "SoC platform selection"
	depends on LTQ_CBM

config PRX300_CQM
	bool "PRX300"
	help
	  CQM driver for PRX300 platform.
if PRX300_CQM
source "drivers/net/ethernet/lantiq/cqm/prx300/Kconfig"
endif

config GRX500_CBM
	bool "GRX500"

	help
	  CBM driver for GRX500 platform.
if GRX500_CBM
source "drivers/net/ethernet/lantiq/cqm/grx500/Kconfig"
endif
endchoice
```

## release/linux/lantiq/linux-4.9/drivers/net/ethernet/lantiq/cqm/grx500/Kconfig
```kconfig
#
# Central Buffer Manager(CBM) configuration
#

menu "CBM_GRX500"

config CBM_STD_BUF_POOL_SIZE
	hex "CBM Standard Buffer pool size"
	depends on LTQ_CBM
	default 0x1200000

config CBM_JBO_BUF_SIZE 
	hex "CBM Jumbo Buffer pool size"
	depends on LTQ_CBM
	default 0x800000

config CBM_JBO_PKT_SIZE 
	hex "CBM Jumbo Packet size"
	depends on LTQ_CBM
	default 0x2000
config CBM_LS_ENABLE
	tristate "CBM loadspreader"
	depends on LTQ_CBM
	default n
	---help---
	Turn on this option to enable CBM LS and TCP packet Marking
	in HW.
endmenu
```

## release/linux/lantiq/linux-4.9/drivers/net/ethernet/lantiq/cqm/prx300/Kconfig
```kconfig
#
# Central Buffer Manager(CBM) configuration
#
menu "CQM_PRX300"
config CBM_LS_ENABLE
	tristate "CBM loadspreader"
	depends on LTQ_CBM
	default n
	---help---
	Turn on this option to enable CBM LS and TCP packet Marking
	in HW.
endmenu
```

## release/linux/lantiq/linux-4.9/drivers/net/ethernet/lantiq/directconnect_dp/Kconfig
```kconfig
#
# DirectConnect Datapath Driver
#
config DIRECTCONNECT_DP_API
       tristate "DirectConnect Datapath API framework"
       default n
       depends on SOC_XWAY || SOC_GRX500
       ---help---
         DirectConnect Datapath API framework support for Intel/Lantiq SoCs.
```

## release/linux/lantiq/linux-4.9/drivers/net/ethernet/lantiq/e160/Kconfig
```kconfig
config INTEL_E160
	tristate "Intel CHD MACsec (E160) HW offload support"
	select MACSEC
	select MACSEC_HW_OFFLOAD
	select CRYPTO_AES
	select CRYPTO_ECB
	---help---
	  This driver provides support for MACsec HW offload.
```

## release/linux/lantiq/linux-4.9/drivers/net/ethernet/lantiq/l2nat/Kconfig
```kconfig
#
# L2NAT configuration
#

config L2NAT
	tristate "Layer 2 nat"
	depends on BRIDGE_NETFILTER
	default n
	---help---
	  Supported Layer 2 network address translation. This configuration is
	  used in the implementation of a wireless bridged client.
```

## release/linux/lantiq/linux-4.9/drivers/net/ethernet/lantiq/ppa/Kconfig
```kconfig
menu "PPA"

config PPA
        bool "Protocol Processing Accelerator"
        depends on LANTIQ
        default n
        ---help---
        Protocol Acceleration Engine

if PPA 

config PPA_QOS
       bool "PPA Quality of Service"
       depends on PPA 
       default y
       ---help---	
       PPA QoS enable

config PPA_API_DIRECTPATH
        bool "Direct Path Support for PPA API"
        depends on PPA
        default y
        ---help---
        Direct Path Support (e.g. WLAN) for PPA API

config PPA_API_DIRECTCONNECT
        bool "Direct connect Support for SOC"
        depends on PPA && SOC_GRX500
        default n
        ---help---
        Direct connect Support (e.g. WLAN) for PPA

config PPA_API_SW_FASTPATH
       bool "PPA software acceleration"
       depends on PPA
       default y
       ---help---       
       PPA software acceleration enable

config PPA_TCP_LITEPATH
       bool "TCP litepath"
       depends on PPA_API_SW_FASTPATH
       default y
       ---help---       
       PPA local TCP session Acceleration

config PPA_TMU_MIB_SUPPORT
        tristate "PPA TMU HAL - kernel APIs"
        depends on PPA && SOC_GRX500
        default y
        help
            TMU HAL MIB APIs support

config PPA_BR_MAC_LEARNING
        bool "Bridge MAC learning"
        depends on PPA
        default n
        help
            Bridge MAC learning support for PPA

config PPA_RT_SESS_LEARNING
        bool "PPA routed session learning"
        depends on PPA
        default y
        help
            Routed session learning support for PPA

config PPA_BR_SESS_LEARNING
        bool "Bridge session learning"
        depends on PPA_RT_SESS_LEARNING
        default n
        help
            Bridge session learning support for PPA

config PPA_MPE_IP97
         tristate "INTEL PPA MPE IP97 Support"
         depends on PPA && SOC_GRX500
         default n
         help
            INTEL PPA MPE IP97 Support

config PPA_EXT_PKT_LEARNING
        bool "External packet learning driver"
        depends on LTQ_PON_ETH && !PPA_RT_SESS_LEARNING
        default n
        help
            External packet learning driver support for PPA

config IPV4_IPV6_COUNTER_SUPPORT
        bool "IPv4 IPv6 counter support"
        depends on PPA
        default n
        help
            IPv4 IPv6 counter support in PPA

endif # PPA
endmenu
```

## release/linux/lantiq/linux-4.9/drivers/net/ethernet/lantiq/ppv4/Kconfig
```kconfig
#
# PPV4 QOS AND BM configuration
#
config LTQ_PPV4
	bool "Buffer Manager and QOS Driver"
	depends on SOC_GRX500
	default n

	---help---
	Turn on this option to enable BM and QOS driver which is a special hardware
	present in the FALCONMX series of SoCs to manage the network buffers
	in HW.

config LTQ_PPV4_QOS
	tristate "QoS driver"
	depends on LTQ_PPV4
	---help---
	  This is the driver for the PPv4 QoS hardware in Falcon Mountain.

	  To compile this driver as a module, choose M here. The module
	  will be called pp_qos_drv.

config LTQ_PPV4_QOS_TEST
	bool "Enable test code for QoS driver"
	depends on LTQ_PPV4_QOS

config LTQ_PPV4_BM
	tristate "BM driver"
	depends on LTQ_PPV4
	---help---
	  This is the driver for the PPv4 BM hardware in Falcon Mountain.
	  To compile this driver as a module, choose M here. The module
	  will be called pp_bm_drv.
```

## release/linux/lantiq/linux-4.9/drivers/net/ethernet/lantiq/qos_mgr/Kconfig
```kconfig
menu "QOS_MGR"

config QOS_MGR
        bool "QoS Manager"
        depends on LANTIQ
        help
            QoS Manager
endmenu
```

## release/linux/lantiq/linux-4.9/drivers/net/ethernet/lantiq/tmu/Kconfig
```kconfig
#
# TMU
#

menuconfig LTQ_TMU
	bool "TMU QoS Support"
	depends on SOC_GRX500 && LTQ_CBM && GRX500_CBM && LTQ_DATAPATH
	default y
	---help---
	  TMU QoS HW Support
	  It only support egress QoS
	  It depends on CBM

if LTQ_TMU

config LTQ_TMU_DDR_SIMULATE_REG
	default n
	bool "Use DDR to Simulate TMU HW Register for testing purpose"
	depends on LTQ_TMU
	---help---
	 Use DDR to Simulate TMU HW Register for testing purpose,
	 especially for hierarchy queue/scheduler setup
	 it is only for simulation purpose, not for real feature

endif # LTQ_TMU
```

## release/linux/lantiq/linux-4.9/drivers/net/ppv4/Kconfig
```kconfig
#
# PPV4 configuration
#
config PPV4
	tristate "Packet Processor V4"
	---help---
	  Packet Processor V4 Driver

config PPV4_LGM
	bool "Packet Processor V4 for LGM"
	depends on PPV4
	---help---
	  Packet Processor V4 Driver for LGM

config PPV4_UT
	bool "Packet Processor V4 Unit test"
	depends on PPV4
	---help---
	  Packet Processor V4 Driver Unit Test

config PPV4_HW_MOD_REGS_LOGS
	bool "Enable logs prints when modifying hw modules registers"
	depends on PPV4
	---help---
	  Set to true if you want to see logs print when modifying hw
	  registers, e.g. QoS, BM, etc...

config PPV4_HW_MOD_REGS_LOGS_EN
	hex "Bitmap specifying which hw modules should be enabled"
	depends on PPV4_HW_MOD_REGS_LOGS
	---help---
	  Set the desired module bit to 1
```

## release/linux/lantiq/linux-4.9/drivers/phy/intel/Kconfig
```kconfig
#
# Phy driver for intel platforms
#

config PHY_INTEL_WAN_XPCS
	tristate "Intel WAN XPCS PHY driver"
	depends on OF
	depends on SOC_GRX500
	select GENERIC_PHY
	help
	  Enable this to support Intel WAN XPCS PHY

config PHY_INTEL_COMBO
	bool "Intel Combo PHY driver"
	depends on OF && HAS_IOMEM
	depends on SOC_GRX500
	select MFD_SYSCON
	select GENERIC_PHY
	help
	  Enable this to support Intel Combo-PHY.
	  Intel Combo-PHY support two separate PCIe,
	  PCIe x2, two separate ethernet PHYs,
	  ethernet PHY x2, or PCIe/Ethernet PHY mixed mode.

config PHY_INTEL_SLIM
	bool "Intel Slim driver"
	depends on OF
	depends on SOC_GRX500
	select MFD_SYSCON
	select GENERIC_PHY
	help
	  Enable this to support Intel GRX500 platform for PCIe PHY.
```

## release/linux/lantiq/linux-4.9/net/mcast_helper/Kconfig
```kconfig
#
# mcast_helper configuration
#

config MCAST_HELPER_PACKAGE
	tristate "Multicast Helper package enable"
	default n
	help
	  mcast_helper support

config MCAST_HELPER_REG
	tristate "Multicast Helper Register Support"
	default n
	help
	  mcast_helper reg support

config MCAST_HELPER
	tristate "Multicast Helper support"
	default n 
	help
	  mcast_helper support

config MCAST_HELPER_ACL
	tristate "Multicast Helper ACL support"
	default n 
	help
	  mcast_helper ACL support
	
config MCAST_HELPER_M2U
	tristate "Multicast Helper multicast to unicast support"
	default n
	help
	  mcast_helper update multicast to unicast support
```

## release/linux/lantiq/linux-4.9/swrt/Kconfig
```kconfig
choice
	prompt "Choose Product"
	help
	   Choose specific product for different hardware layout

config RAX40
	bool "rax40 (grx350 + wav624)"


endchoice
```

## release/linux/mtk/linux-4.14/drivers/mtd/nand/spi/Kconfig
```kconfig
menuconfig MTD_SPI_NAND
	tristate "SPI NAND device Support"
	select MTD_NAND_CORE
	depends on SPI_MASTER
	depends on SOC_MT7621
	select SPI_MEM
	help
	  This is the framework for the SPI NAND device drivers.
```

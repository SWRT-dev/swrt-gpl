## release/linux/mtk/linux-4.14/drivers/net/wireless/mediatek/Kconfig
```kconfig
config WLAN_VENDOR_MEDIATEK
	bool "MediaTek devices"
	default y
	---help---
	  If you have a wireless card belonging to this class, say Y.

	  Note that the answer to this question doesn't directly affect the
	  kernel: saying N will just cause the configurator to skip all
	  the questions about  cards. If you say Y, you will be asked for
	  your specific card in the following questions.

if WLAN_VENDOR_MEDIATEK
source "drivers/net/wireless/mediatek/mt7601u/Kconfig"

menuconfig WIFI_DRIVER
	bool "WiFi Driver Support"

if WIFI_DRIVER

choice
	prompt "Choose First WiFi Interface"
	config FIRST_IF_NONE
	bool "None"

	config FIRST_IF_MT7603E
	bool "MT7603E"
	select WIFI_MT_MAC
	select MT_MAC

	config FIRST_IF_MT7615E
	bool "MT7615E"
	select WIFI_MT_MAC
	select MT_MAC

	config FIRST_IF_MT7622
	bool "MT7622"
	select WIFI_MT_MAC
	select MT_MAC

	config FIRST_IF_MT7626
	bool "MT7626"
	select WIFI_MT_MAC
	select MT_MAC

	config FIRST_IF_MT7915
	bool "MT7915"
	select WIFI_MT_MAC
	select MT_MAC

endchoice

choice
	prompt "Choose Second WiFi Interface"
	config SECOND_IF_NONE
	bool "None"

	config SECOND_IF_MT7615E
	bool "MT7615E"
	select WIFI_MT_MAC
	select MULTI_INF_SUPPORT

endchoice

choice
	prompt "Choose Third WiFi Interface"
	config THIRD_IF_NONE
	bool "None"

	config THIRD_IF_MT7615E
	bool "MT7615E"
	select WIFI_MT_MAC
	select MULTI_INF_SUPPORT

endchoice

config  RT_FIRST_CARD
        int
        depends on ! FIRST_IF_NONE
		default 7615 if FIRST_IF_MT7615E
        default 7622 if FIRST_IF_MT7622
        default 7622 if FIRST_IF_MT7626
        default 7915 if FIRST_IF_MT7915
        default 7603 if FIRST_IF_MT7603E

config  RT_SECOND_CARD
        int
        depends on ! SECOND_IF_NONE
        default 7615 if SECOND_IF_MT7615E

config  RT_THIRD_CARD
        int
        depends on ! THIRD_IF_NONE
        default 7615 if THIRD_IF_MT7615E

config  RT_FIRST_IF_RF_OFFSET
        hex
        depends on !FIRST_IF_NONE
        default 0xc0000 if FIRST_IF_MT7915
		default 0x0 if FIRST_IF_MT7615E
		default 0x0 if FIRST_IF_MT7603E

config  RT_SECOND_IF_RF_OFFSET
        hex
        depends on !SECOND_IF_NONE
        default 0xc8000 if !SECOND_IF_MT7615E
		default 0x4000 if SECOND_IF_MT7615E

config  RT_THIRD_IF_RF_OFFSET
        hex
        depends on !THIRD_IF_NONE
        default 0xd0000
if (FIRST_IF_MT7615E || SECOND_IF_MT7615E)
menu "MediaTek MT7615E PCIe Wireless driver"
source "drivers/net/wireless/mediatek/mt7615/5.1.0.0/mt_wifi/embedded/Kconfig"
endmenu
endif

if (FIRST_IF_MT7603)
menu "MediaTek MT76x3 PCIe Wireless driver"
source "drivers/net/wireless/mediatek/mt7603/4.1.2.1/mt7603_wifi/Kconfig"
endmenu
endif

if (FIRST_IF_MT7915)
menu "MediaTek MT7915 PCIe Wireless driver"
source "drivers/net/wireless/mediatek/mt7915/7.4.0.0/mt_wifi/embedded/Kconfig"
endmenu
endif

endif # WIFI_DRIVER
endif # WLAN_VENDOR_MEDIATEK
```

## release/linux/mtk/linux-5.4/drivers/net/wireless/mediatek/mt7986/warp_driver/warp/Kconfig
```kconfig
config WARP_VERSION
        int "WARP Driver HW Version Support"
        range 1 3
        default 1 if TARGET_mediatek_mt7622
        default 2 if TARGET_mediatek_mt7627
        default 3 if TARGET_mediatek_mt7988

config WARP_ATC_SUPPORT
        bool "WARP Driver Address Translate Support for CR mirror"
        default y

config WARP_DBG_SUPPORT
        bool "WARP Driver Debug Info Support"
        default y

config WARP_WDMA_RECYCLE_SUPPORT
        bool "WARP WDMA Recycle Support"
        default n

config WED_HW_RRO_SUPPORT
        bool "WED HW RRO Support"
        default n
```

## release/linux/mtk/linux-5.4/drivers/net/wireless/mediatek/mt798x/7.6.7.0/warp_driver/warp/Kconfig
```kconfig
config WARP_VERSION
        int "WARP Driver HW Version Support"
        range 1 3
        default 1 if TARGET_mediatek_mt7622
        default 2 if TARGET_mediatek_mt7627
        default 3 if TARGET_mediatek_mt7988

config WARP_ATC_SUPPORT
        bool "WARP Driver Address Translate Support for CR mirror"
        default y

config WARP_DBG_SUPPORT
        bool "WARP Driver Debug Info Support"
        default y

config WARP_WDMA_RECYCLE_SUPPORT
        bool "WARP WDMA Recycle Support"
        default n

config WED_HW_RRO_SUPPORT
        bool "WED HW RRO Support"
        default n

config WARP_CHIPSET
		string "WARP target chipset"
		default mt7986 if FIRST_IF_MT7986

config WARP_MEMORY_LEAK_DBG
		bool "Memory leak debug"
		depends on !MTK_MEMORY_SHRINK && WARP_DBG_SUPPORT
        default y

config WARP_WO_EMBEDDED_LOAD
		bool "Emebedded MCU firmware support"
		default n
		help
			Once enabled, firmware download flow try embedded version once externel version being invalid.
```

## release/linux/mtk/linux-5.4/drivers/nvram/Kconfig
```kconfig
menu "ASUS NVRAM"

config	ASUS_NVRAM_API
	tristate "ASUS NVRAM R/W API"
	default m
	---help---
	ASUS NVRAM R/W API

config NVRAM_64K
	bool "Support nvram 64K. In fact, only 60KB for Ralink platfrom and the first 4KB is used by uboot."
	depends on ASUS_NVRAM_API
	default n

config NVRAM_SIZE
	hex "Specify nvram size on MT798X platform "
 	depends on ASUS_NVRAM_API && ARM64
	default 0x10000

endmenu
```

## release/linux/mtk/linux-5.4/ralink/Kconfig.misc
```kconfig
menu "ASUS Miscellaneous options"

config  SINGLE_SKU_IN_DRIVER
        bool "Single sku in driver, not file"
        default n

#config  MTD_JFFS2_LEN
#        hex "MTD JFFS2 Partition Length (Unit:Bytes)"
#        default 0x0

config  MODEL_RTACRH18
        bool "RT-ACRH18"
        default n

config  MODEL_RT4GAX56
        bool "RT-4GAX56"
        default n

config  MODEL_RTAX53U
        bool "RT-AX53U"
        default n

config  MODEL_RTAX54
        bool "RT-AX54"
        default n

config  MODEL_RT4GAC86U
        bool "4G-AC86U"
        default n

config  MODEL_RTAC85U
        bool "RT-AC85U"
        default n

config  MODEL_RTAC85P
        bool "RT-AC85P"
        default n

config  MODEL_R6800
        bool "R6800"
        default n

config  MODEL_RMAC2100
        bool "RMAC2100"
        default n

config  MODEL_PGBM1
        bool "PGBM1"
        default n

config  MODEL_JCGQ10PRO
        bool "JCG-Q10PRO"
        default n

config  MODEL_H3CTX1801
        bool "H3C-TX1801"
        default n

config  MODEL_RMAX6000
        bool "Redmi AX6000"
        default n

config  MODEL_SWRT360T7
        bool "360T7"
        default n

config MODEL_PANTHERA
		bool "Panther porting on PantherA RFB"
        default n

config MODEL_PANTHERB
		bool "Panther porting on PantherB RFB"
        default n

config MODEL_CHEETAH
		bool "Cheetah porting on Cheetah RFB"
        default n

config MODEL_TUFAX4200
		bool "Panther TUF-AX4200/TUF-AX4200Q"
        default n

config MODEL_TUFAX6000
		bool "Panther TUF-AX6000"
        default n

config MODEL_RTAX59U
		bool "Panther RT-AX59U"
        default n

config MODEL_PRTAX57_GO
	bool "Cheetah PRT-AX57_GO"

config MODEL_RTAX52
	bool "Cheetah RT-AX52"

config MODEL_RTAX57M
	bool "Cheetah RT-AX57M"

config  ASUS_EXT
        bool "ASUS_EXT"
        default n

config  MTK_NAND_BLOCK2
        bool "For MTK nand using 2 block"
        default n

config  FIBOCOM_FG621
        bool "LTE module FIBOCOM FG621"
        default n

endmenu        
```
